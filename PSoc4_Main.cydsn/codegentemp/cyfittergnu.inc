.ifndef INCLUDED_CYFITTERGNU_INC
.set INCLUDED_CYFITTERGNU_INC, 1
.include "cydevicegnu_trm.inc"

/* ADC_ACCELEROMETER_cy_psoc4_sarmux_8 */
.set ADC_ACCELEROMETER_cy_psoc4_sarmux_8__CH_0_PIN, 3
.set ADC_ACCELEROMETER_cy_psoc4_sarmux_8__CH_0_PORT, 0
.set ADC_ACCELEROMETER_cy_psoc4_sarmux_8__CH_1_PIN, 1
.set ADC_ACCELEROMETER_cy_psoc4_sarmux_8__CH_1_PORT, 0
.set ADC_ACCELEROMETER_cy_psoc4_sarmux_8__CH_2_PIN, 0
.set ADC_ACCELEROMETER_cy_psoc4_sarmux_8__CH_2_PORT, 0
.set ADC_ACCELEROMETER_cy_psoc4_sarmux_8__SAR_CHAN_CONFIG00, CYREG_SAR_CHAN_CONFIG00
.set ADC_ACCELEROMETER_cy_psoc4_sarmux_8__SAR_CHAN_CONFIG01, CYREG_SAR_CHAN_CONFIG01
.set ADC_ACCELEROMETER_cy_psoc4_sarmux_8__SAR_CHAN_CONFIG02, CYREG_SAR_CHAN_CONFIG02
.set ADC_ACCELEROMETER_cy_psoc4_sarmux_8__SAR_CHAN_CONFIG03, CYREG_SAR_CHAN_CONFIG03
.set ADC_ACCELEROMETER_cy_psoc4_sarmux_8__SAR_CHAN_CONFIG04, CYREG_SAR_CHAN_CONFIG04
.set ADC_ACCELEROMETER_cy_psoc4_sarmux_8__SAR_CHAN_CONFIG05, CYREG_SAR_CHAN_CONFIG05
.set ADC_ACCELEROMETER_cy_psoc4_sarmux_8__SAR_CHAN_CONFIG06, CYREG_SAR_CHAN_CONFIG06
.set ADC_ACCELEROMETER_cy_psoc4_sarmux_8__SAR_CHAN_CONFIG07, CYREG_SAR_CHAN_CONFIG07
.set ADC_ACCELEROMETER_cy_psoc4_sarmux_8__SAR_CHAN_EN, CYREG_SAR_CHAN_EN
.set ADC_ACCELEROMETER_cy_psoc4_sarmux_8__SAR_CHAN_RESULT00, CYREG_SAR_CHAN_RESULT00
.set ADC_ACCELEROMETER_cy_psoc4_sarmux_8__SAR_CHAN_RESULT01, CYREG_SAR_CHAN_RESULT01
.set ADC_ACCELEROMETER_cy_psoc4_sarmux_8__SAR_CHAN_RESULT02, CYREG_SAR_CHAN_RESULT02
.set ADC_ACCELEROMETER_cy_psoc4_sarmux_8__SAR_CHAN_RESULT03, CYREG_SAR_CHAN_RESULT03
.set ADC_ACCELEROMETER_cy_psoc4_sarmux_8__SAR_CHAN_RESULT04, CYREG_SAR_CHAN_RESULT04
.set ADC_ACCELEROMETER_cy_psoc4_sarmux_8__SAR_CHAN_RESULT05, CYREG_SAR_CHAN_RESULT05
.set ADC_ACCELEROMETER_cy_psoc4_sarmux_8__SAR_CHAN_RESULT06, CYREG_SAR_CHAN_RESULT06
.set ADC_ACCELEROMETER_cy_psoc4_sarmux_8__SAR_CHAN_RESULT07, CYREG_SAR_CHAN_RESULT07
.set ADC_ACCELEROMETER_cy_psoc4_sarmux_8__SAR_CHAN_RESULT_VALID, CYREG_SAR_CHAN_RESULT_VALID
.set ADC_ACCELEROMETER_cy_psoc4_sarmux_8__SAR_CHAN_WORK00, CYREG_SAR_CHAN_WORK00
.set ADC_ACCELEROMETER_cy_psoc4_sarmux_8__SAR_CHAN_WORK01, CYREG_SAR_CHAN_WORK01
.set ADC_ACCELEROMETER_cy_psoc4_sarmux_8__SAR_CHAN_WORK02, CYREG_SAR_CHAN_WORK02
.set ADC_ACCELEROMETER_cy_psoc4_sarmux_8__SAR_CHAN_WORK03, CYREG_SAR_CHAN_WORK03
.set ADC_ACCELEROMETER_cy_psoc4_sarmux_8__SAR_CHAN_WORK04, CYREG_SAR_CHAN_WORK04
.set ADC_ACCELEROMETER_cy_psoc4_sarmux_8__SAR_CHAN_WORK05, CYREG_SAR_CHAN_WORK05
.set ADC_ACCELEROMETER_cy_psoc4_sarmux_8__SAR_CHAN_WORK06, CYREG_SAR_CHAN_WORK06
.set ADC_ACCELEROMETER_cy_psoc4_sarmux_8__SAR_CHAN_WORK07, CYREG_SAR_CHAN_WORK07
.set ADC_ACCELEROMETER_cy_psoc4_sarmux_8__SAR_CHAN_WORK_VALID, CYREG_SAR_CHAN_WORK_VALID
.set ADC_ACCELEROMETER_cy_psoc4_sarmux_8__SAR_INJ_CHAN_CONFIG, CYREG_SAR_INJ_CHAN_CONFIG
.set ADC_ACCELEROMETER_cy_psoc4_sarmux_8__SAR_INJ_RESULT, CYREG_SAR_INJ_RESULT
.set ADC_ACCELEROMETER_cy_psoc4_sarmux_8__SAR_START_CTRL, CYREG_SAR_START_CTRL

/* ADC_ACCELEROMETER_cy_psoc4_sar */
.set ADC_ACCELEROMETER_cy_psoc4_sar__SAR_CTRL, CYREG_SAR_CTRL
.set ADC_ACCELEROMETER_cy_psoc4_sar__SAR_INTR, CYREG_SAR_INTR
.set ADC_ACCELEROMETER_cy_psoc4_sar__SAR_INTR_CAUSE, CYREG_SAR_INTR_CAUSE
.set ADC_ACCELEROMETER_cy_psoc4_sar__SAR_INTR_MASK, CYREG_SAR_INTR_MASK
.set ADC_ACCELEROMETER_cy_psoc4_sar__SAR_INTR_MASKED, CYREG_SAR_INTR_MASKED
.set ADC_ACCELEROMETER_cy_psoc4_sar__SAR_INTR_SET, CYREG_SAR_INTR_SET
.set ADC_ACCELEROMETER_cy_psoc4_sar__SAR_NUMBER, 0
.set ADC_ACCELEROMETER_cy_psoc4_sar__SAR_RANGE_COND, CYREG_SAR_RANGE_COND
.set ADC_ACCELEROMETER_cy_psoc4_sar__SAR_RANGE_INTR_MASK, CYREG_SAR_RANGE_INTR_MASK
.set ADC_ACCELEROMETER_cy_psoc4_sar__SAR_RANGE_INTR_MASKED, CYREG_SAR_RANGE_INTR_MASKED
.set ADC_ACCELEROMETER_cy_psoc4_sar__SAR_RANGE_INTR_SET, CYREG_SAR_RANGE_INTR_SET
.set ADC_ACCELEROMETER_cy_psoc4_sar__SAR_RANGE_THRES, CYREG_SAR_RANGE_THRES
.set ADC_ACCELEROMETER_cy_psoc4_sar__SAR_SAMPLE_CTRL, CYREG_SAR_SAMPLE_CTRL
.set ADC_ACCELEROMETER_cy_psoc4_sar__SAR_SAMPLE_TIME01, CYREG_SAR_SAMPLE_TIME01
.set ADC_ACCELEROMETER_cy_psoc4_sar__SAR_SAMPLE_TIME23, CYREG_SAR_SAMPLE_TIME23
.set ADC_ACCELEROMETER_cy_psoc4_sar__SAR_SATURATE_INTR_MASK, CYREG_SAR_SATURATE_INTR_MASK
.set ADC_ACCELEROMETER_cy_psoc4_sar__SAR_SATURATE_INTR_MASKED, CYREG_SAR_SATURATE_INTR_MASKED
.set ADC_ACCELEROMETER_cy_psoc4_sar__SAR_SATURATE_INTR_SET, CYREG_SAR_SATURATE_INTR_SET

/* ADC_ACCELEROMETER_intClock */
.set ADC_ACCELEROMETER_intClock__DIVIDER_MASK, 0x0000FFFF
.set ADC_ACCELEROMETER_intClock__ENABLE, CYREG_CLK_DIVIDER_A00
.set ADC_ACCELEROMETER_intClock__ENABLE_MASK, 0x80000000
.set ADC_ACCELEROMETER_intClock__MASK, 0x80000000
.set ADC_ACCELEROMETER_intClock__REGISTER, CYREG_CLK_DIVIDER_A00

/* BLUE_TXInternalInterrupt */
.set BLUE_TXInternalInterrupt__INTC_CLR_EN_REG, CYREG_CM0_ICER
.set BLUE_TXInternalInterrupt__INTC_CLR_PD_REG, CYREG_CM0_ICPR
.set BLUE_TXInternalInterrupt__INTC_MASK, 0x01
.set BLUE_TXInternalInterrupt__INTC_NUMBER, 0
.set BLUE_TXInternalInterrupt__INTC_PRIOR_MASK, 0xC0
.set BLUE_TXInternalInterrupt__INTC_PRIOR_NUM, 3
.set BLUE_TXInternalInterrupt__INTC_PRIOR_REG, CYREG_CM0_IPR0
.set BLUE_TXInternalInterrupt__INTC_SET_EN_REG, CYREG_CM0_ISER
.set BLUE_TXInternalInterrupt__INTC_SET_PD_REG, CYREG_CM0_ISPR

/* ADC_ACCELEROMETER_IRQ */
.set ADC_ACCELEROMETER_IRQ__INTC_CLR_EN_REG, CYREG_CM0_ICER
.set ADC_ACCELEROMETER_IRQ__INTC_CLR_PD_REG, CYREG_CM0_ICPR
.set ADC_ACCELEROMETER_IRQ__INTC_MASK, 0x4000
.set ADC_ACCELEROMETER_IRQ__INTC_NUMBER, 14
.set ADC_ACCELEROMETER_IRQ__INTC_PRIOR_MASK, 0xC00000
.set ADC_ACCELEROMETER_IRQ__INTC_PRIOR_NUM, 3
.set ADC_ACCELEROMETER_IRQ__INTC_PRIOR_REG, CYREG_CM0_IPR3
.set ADC_ACCELEROMETER_IRQ__INTC_SET_EN_REG, CYREG_CM0_ISER
.set ADC_ACCELEROMETER_IRQ__INTC_SET_PD_REG, CYREG_CM0_ISPR

/* BLUE_IntClock */
.set BLUE_IntClock__DIVIDER_MASK, 0x0000FFFF
.set BLUE_IntClock__ENABLE, CYREG_CLK_DIVIDER_C00
.set BLUE_IntClock__ENABLE_MASK, 0x80000000
.set BLUE_IntClock__MASK, 0x80000000
.set BLUE_IntClock__REGISTER, CYREG_CLK_DIVIDER_C00

/* PSOC5_SCBCLK */
.set PSOC5_SCBCLK__DIVIDER_MASK, 0x0000FFFF
.set PSOC5_SCBCLK__ENABLE, CYREG_CLK_DIVIDER_B00
.set PSOC5_SCBCLK__ENABLE_MASK, 0x80000000
.set PSOC5_SCBCLK__MASK, 0x80000000
.set PSOC5_SCBCLK__REGISTER, CYREG_CLK_DIVIDER_B00

/* BLUE_BUART */
.set BLUE_BUART_sRX_RxBitCounter_ST__16BIT_STATUS_AUX_CTL_REG, CYREG_UDB_W16_ACTL_00
.set BLUE_BUART_sRX_RxBitCounter_ST__16BIT_STATUS_REG, CYREG_UDB_W16_ST_00
.set BLUE_BUART_sRX_RxBitCounter_ST__32BIT_MASK_REG, CYREG_UDB_W32_MSK_00
.set BLUE_BUART_sRX_RxBitCounter_ST__32BIT_STATUS_AUX_CTL_REG, CYREG_UDB_W32_ACTL_00
.set BLUE_BUART_sRX_RxBitCounter_ST__32BIT_STATUS_REG, CYREG_UDB_W32_ST_00
.set BLUE_BUART_sRX_RxBitCounter_ST__MASK_REG, CYREG_UDB_W8_MSK_00
.set BLUE_BUART_sRX_RxBitCounter_ST__MASK_ST_AUX_CTL_REG, CYREG_UDB_CAT16_ACTL_MSK_00
.set BLUE_BUART_sRX_RxBitCounter_ST__PER_ST_AUX_CTL_REG, CYREG_UDB_CAT16_ACTL_MSK_00
.set BLUE_BUART_sRX_RxBitCounter_ST__STATUS_AUX_CTL_REG, CYREG_UDB_W8_ACTL_00
.set BLUE_BUART_sRX_RxBitCounter_ST__STATUS_CNT_REG, CYREG_UDB_CAT16_CTL_ST_00
.set BLUE_BUART_sRX_RxBitCounter_ST__STATUS_CONTROL_REG, CYREG_UDB_CAT16_CTL_ST_00
.set BLUE_BUART_sRX_RxBitCounter_ST__STATUS_REG, CYREG_UDB_W8_ST_00
.set BLUE_BUART_sRX_RxBitCounter__16BIT_CONTROL_AUX_CTL_REG, CYREG_UDB_W16_ACTL_00
.set BLUE_BUART_sRX_RxBitCounter__16BIT_CONTROL_CONTROL_REG, CYREG_UDB_W16_CTL_00
.set BLUE_BUART_sRX_RxBitCounter__16BIT_CONTROL_COUNT_REG, CYREG_UDB_W16_CTL_00
.set BLUE_BUART_sRX_RxBitCounter__16BIT_COUNT_CONTROL_REG, CYREG_UDB_W16_CTL_00
.set BLUE_BUART_sRX_RxBitCounter__16BIT_COUNT_COUNT_REG, CYREG_UDB_W16_CTL_00
.set BLUE_BUART_sRX_RxBitCounter__16BIT_MASK_MASK_REG, CYREG_UDB_W16_MSK_00
.set BLUE_BUART_sRX_RxBitCounter__16BIT_MASK_PERIOD_REG, CYREG_UDB_W16_MSK_00
.set BLUE_BUART_sRX_RxBitCounter__16BIT_PERIOD_MASK_REG, CYREG_UDB_W16_MSK_00
.set BLUE_BUART_sRX_RxBitCounter__16BIT_PERIOD_PERIOD_REG, CYREG_UDB_W16_MSK_00
.set BLUE_BUART_sRX_RxBitCounter__32BIT_CONTROL_AUX_CTL_REG, CYREG_UDB_W32_ACTL_00
.set BLUE_BUART_sRX_RxBitCounter__32BIT_CONTROL_REG, CYREG_UDB_W32_CTL_00
.set BLUE_BUART_sRX_RxBitCounter__32BIT_COUNT_REG, CYREG_UDB_W32_CTL_00
.set BLUE_BUART_sRX_RxBitCounter__32BIT_PERIOD_REG, CYREG_UDB_W32_MSK_00
.set BLUE_BUART_sRX_RxBitCounter__CONTROL_AUX_CTL_REG, CYREG_UDB_W8_ACTL_00
.set BLUE_BUART_sRX_RxBitCounter__CONTROL_REG, CYREG_UDB_W8_CTL_00
.set BLUE_BUART_sRX_RxBitCounter__CONTROL_ST_REG, CYREG_UDB_CAT16_CTL_ST_00
.set BLUE_BUART_sRX_RxBitCounter__COUNT_REG, CYREG_UDB_W8_CTL_00
.set BLUE_BUART_sRX_RxBitCounter__COUNT_ST_REG, CYREG_UDB_CAT16_CTL_ST_00
.set BLUE_BUART_sRX_RxBitCounter__MASK_CTL_AUX_CTL_REG, CYREG_UDB_CAT16_ACTL_MSK_00
.set BLUE_BUART_sRX_RxBitCounter__PERIOD_REG, CYREG_UDB_W8_MSK_00
.set BLUE_BUART_sRX_RxBitCounter__PER_CTL_AUX_CTL_REG, CYREG_UDB_CAT16_ACTL_MSK_00
.set BLUE_BUART_sRX_RxShifter_u0__16BIT_A0_REG, CYREG_UDB_W16_A0_00
.set BLUE_BUART_sRX_RxShifter_u0__16BIT_A1_REG, CYREG_UDB_W16_A1_00
.set BLUE_BUART_sRX_RxShifter_u0__16BIT_D0_REG, CYREG_UDB_W16_D0_00
.set BLUE_BUART_sRX_RxShifter_u0__16BIT_D1_REG, CYREG_UDB_W16_D1_00
.set BLUE_BUART_sRX_RxShifter_u0__16BIT_DP_AUX_CTL_REG, CYREG_UDB_W16_ACTL_00
.set BLUE_BUART_sRX_RxShifter_u0__16BIT_F0_REG, CYREG_UDB_W16_F0_00
.set BLUE_BUART_sRX_RxShifter_u0__16BIT_F1_REG, CYREG_UDB_W16_F1_00
.set BLUE_BUART_sRX_RxShifter_u0__32BIT_A0_REG, CYREG_UDB_W32_A0_00
.set BLUE_BUART_sRX_RxShifter_u0__32BIT_A1_REG, CYREG_UDB_W32_A1_00
.set BLUE_BUART_sRX_RxShifter_u0__32BIT_D0_REG, CYREG_UDB_W32_D0_00
.set BLUE_BUART_sRX_RxShifter_u0__32BIT_D1_REG, CYREG_UDB_W32_D1_00
.set BLUE_BUART_sRX_RxShifter_u0__32BIT_DP_AUX_CTL_REG, CYREG_UDB_W32_ACTL_00
.set BLUE_BUART_sRX_RxShifter_u0__32BIT_F0_REG, CYREG_UDB_W32_F0_00
.set BLUE_BUART_sRX_RxShifter_u0__32BIT_F1_REG, CYREG_UDB_W32_F1_00
.set BLUE_BUART_sRX_RxShifter_u0__A0_A1_REG, CYREG_UDB_CAT16_A_00
.set BLUE_BUART_sRX_RxShifter_u0__A0_REG, CYREG_UDB_W8_A0_00
.set BLUE_BUART_sRX_RxShifter_u0__A1_REG, CYREG_UDB_W8_A1_00
.set BLUE_BUART_sRX_RxShifter_u0__D0_D1_REG, CYREG_UDB_CAT16_D_00
.set BLUE_BUART_sRX_RxShifter_u0__D0_REG, CYREG_UDB_W8_D0_00
.set BLUE_BUART_sRX_RxShifter_u0__D1_REG, CYREG_UDB_W8_D1_00
.set BLUE_BUART_sRX_RxShifter_u0__DP_AUX_CTL_REG, CYREG_UDB_W8_ACTL_00
.set BLUE_BUART_sRX_RxShifter_u0__F0_F1_REG, CYREG_UDB_CAT16_F_00
.set BLUE_BUART_sRX_RxShifter_u0__F0_REG, CYREG_UDB_W8_F0_00
.set BLUE_BUART_sRX_RxShifter_u0__F1_REG, CYREG_UDB_W8_F1_00
.set BLUE_BUART_sRX_RxShifter_u0__MSK_DP_AUX_CTL_REG, CYREG_UDB_CAT16_ACTL_MSK_00
.set BLUE_BUART_sRX_RxShifter_u0__PER_DP_AUX_CTL_REG, CYREG_UDB_CAT16_ACTL_MSK_00
.set BLUE_BUART_sRX_RxSts__16BIT_STATUS_AUX_CTL_REG, CYREG_UDB_W16_ACTL_01
.set BLUE_BUART_sRX_RxSts__16BIT_STATUS_REG, CYREG_UDB_W16_ST_01
.set BLUE_BUART_sRX_RxSts__3__MASK, 0x08
.set BLUE_BUART_sRX_RxSts__3__POS, 3
.set BLUE_BUART_sRX_RxSts__4__MASK, 0x10
.set BLUE_BUART_sRX_RxSts__4__POS, 4
.set BLUE_BUART_sRX_RxSts__5__MASK, 0x20
.set BLUE_BUART_sRX_RxSts__5__POS, 5
.set BLUE_BUART_sRX_RxSts__MASK, 0x38
.set BLUE_BUART_sRX_RxSts__MASK_REG, CYREG_UDB_W8_MSK_01
.set BLUE_BUART_sRX_RxSts__STATUS_AUX_CTL_REG, CYREG_UDB_W8_ACTL_01
.set BLUE_BUART_sRX_RxSts__STATUS_REG, CYREG_UDB_W8_ST_01
.set BLUE_BUART_sTX_TxShifter_u0__16BIT_A0_REG, CYREG_UDB_W16_A0_02
.set BLUE_BUART_sTX_TxShifter_u0__16BIT_A1_REG, CYREG_UDB_W16_A1_02
.set BLUE_BUART_sTX_TxShifter_u0__16BIT_D0_REG, CYREG_UDB_W16_D0_02
.set BLUE_BUART_sTX_TxShifter_u0__16BIT_D1_REG, CYREG_UDB_W16_D1_02
.set BLUE_BUART_sTX_TxShifter_u0__16BIT_DP_AUX_CTL_REG, CYREG_UDB_W16_ACTL_02
.set BLUE_BUART_sTX_TxShifter_u0__16BIT_F0_REG, CYREG_UDB_W16_F0_02
.set BLUE_BUART_sTX_TxShifter_u0__16BIT_F1_REG, CYREG_UDB_W16_F1_02
.set BLUE_BUART_sTX_TxShifter_u0__A0_A1_REG, CYREG_UDB_CAT16_A_02
.set BLUE_BUART_sTX_TxShifter_u0__A0_REG, CYREG_UDB_W8_A0_02
.set BLUE_BUART_sTX_TxShifter_u0__A1_REG, CYREG_UDB_W8_A1_02
.set BLUE_BUART_sTX_TxShifter_u0__D0_D1_REG, CYREG_UDB_CAT16_D_02
.set BLUE_BUART_sTX_TxShifter_u0__D0_REG, CYREG_UDB_W8_D0_02
.set BLUE_BUART_sTX_TxShifter_u0__D1_REG, CYREG_UDB_W8_D1_02
.set BLUE_BUART_sTX_TxShifter_u0__DP_AUX_CTL_REG, CYREG_UDB_W8_ACTL_02
.set BLUE_BUART_sTX_TxShifter_u0__F0_F1_REG, CYREG_UDB_CAT16_F_02
.set BLUE_BUART_sTX_TxShifter_u0__F0_REG, CYREG_UDB_W8_F0_02
.set BLUE_BUART_sTX_TxShifter_u0__F1_REG, CYREG_UDB_W8_F1_02
.set BLUE_BUART_sTX_TxSts__0__MASK, 0x01
.set BLUE_BUART_sTX_TxSts__0__POS, 0
.set BLUE_BUART_sTX_TxSts__16BIT_STATUS_AUX_CTL_REG, CYREG_UDB_W16_ACTL_02
.set BLUE_BUART_sTX_TxSts__16BIT_STATUS_REG, CYREG_UDB_W16_ST_02
.set BLUE_BUART_sTX_TxSts__1__MASK, 0x02
.set BLUE_BUART_sTX_TxSts__1__POS, 1
.set BLUE_BUART_sTX_TxSts__2__MASK, 0x04
.set BLUE_BUART_sTX_TxSts__2__POS, 2
.set BLUE_BUART_sTX_TxSts__3__MASK, 0x08
.set BLUE_BUART_sTX_TxSts__3__POS, 3
.set BLUE_BUART_sTX_TxSts__MASK, 0x0F
.set BLUE_BUART_sTX_TxSts__MASK_REG, CYREG_UDB_W8_MSK_02
.set BLUE_BUART_sTX_TxSts__STATUS_AUX_CTL_REG, CYREG_UDB_W8_ACTL_02
.set BLUE_BUART_sTX_TxSts__STATUS_REG, CYREG_UDB_W8_ST_02
.set BLUE_BUART_sTX_sCLOCK_TxBitClkGen__A0_A1_REG, CYREG_UDB_CAT16_A_03
.set BLUE_BUART_sTX_sCLOCK_TxBitClkGen__A0_REG, CYREG_UDB_W8_A0_03
.set BLUE_BUART_sTX_sCLOCK_TxBitClkGen__A1_REG, CYREG_UDB_W8_A1_03
.set BLUE_BUART_sTX_sCLOCK_TxBitClkGen__D0_D1_REG, CYREG_UDB_CAT16_D_03
.set BLUE_BUART_sTX_sCLOCK_TxBitClkGen__D0_REG, CYREG_UDB_W8_D0_03
.set BLUE_BUART_sTX_sCLOCK_TxBitClkGen__D1_REG, CYREG_UDB_W8_D1_03
.set BLUE_BUART_sTX_sCLOCK_TxBitClkGen__DP_AUX_CTL_REG, CYREG_UDB_W8_ACTL_03
.set BLUE_BUART_sTX_sCLOCK_TxBitClkGen__F0_F1_REG, CYREG_UDB_CAT16_F_03
.set BLUE_BUART_sTX_sCLOCK_TxBitClkGen__F0_REG, CYREG_UDB_W8_F0_03
.set BLUE_BUART_sTX_sCLOCK_TxBitClkGen__F1_REG, CYREG_UDB_W8_F1_03

/* PSOC5_SCB */
.set PSOC5_SCB__BIST_CONTROL, CYREG_SCB1_BIST_CONTROL
.set PSOC5_SCB__BIST_DATA, CYREG_SCB1_BIST_DATA
.set PSOC5_SCB__CTRL, CYREG_SCB1_CTRL
.set PSOC5_SCB__EZ_DATA00, CYREG_SCB1_EZ_DATA00
.set PSOC5_SCB__EZ_DATA01, CYREG_SCB1_EZ_DATA01
.set PSOC5_SCB__EZ_DATA02, CYREG_SCB1_EZ_DATA02
.set PSOC5_SCB__EZ_DATA03, CYREG_SCB1_EZ_DATA03
.set PSOC5_SCB__EZ_DATA04, CYREG_SCB1_EZ_DATA04
.set PSOC5_SCB__EZ_DATA05, CYREG_SCB1_EZ_DATA05
.set PSOC5_SCB__EZ_DATA06, CYREG_SCB1_EZ_DATA06
.set PSOC5_SCB__EZ_DATA07, CYREG_SCB1_EZ_DATA07
.set PSOC5_SCB__EZ_DATA08, CYREG_SCB1_EZ_DATA08
.set PSOC5_SCB__EZ_DATA09, CYREG_SCB1_EZ_DATA09
.set PSOC5_SCB__EZ_DATA10, CYREG_SCB1_EZ_DATA10
.set PSOC5_SCB__EZ_DATA11, CYREG_SCB1_EZ_DATA11
.set PSOC5_SCB__EZ_DATA12, CYREG_SCB1_EZ_DATA12
.set PSOC5_SCB__EZ_DATA13, CYREG_SCB1_EZ_DATA13
.set PSOC5_SCB__EZ_DATA14, CYREG_SCB1_EZ_DATA14
.set PSOC5_SCB__EZ_DATA15, CYREG_SCB1_EZ_DATA15
.set PSOC5_SCB__EZ_DATA16, CYREG_SCB1_EZ_DATA16
.set PSOC5_SCB__EZ_DATA17, CYREG_SCB1_EZ_DATA17
.set PSOC5_SCB__EZ_DATA18, CYREG_SCB1_EZ_DATA18
.set PSOC5_SCB__EZ_DATA19, CYREG_SCB1_EZ_DATA19
.set PSOC5_SCB__EZ_DATA20, CYREG_SCB1_EZ_DATA20
.set PSOC5_SCB__EZ_DATA21, CYREG_SCB1_EZ_DATA21
.set PSOC5_SCB__EZ_DATA22, CYREG_SCB1_EZ_DATA22
.set PSOC5_SCB__EZ_DATA23, CYREG_SCB1_EZ_DATA23
.set PSOC5_SCB__EZ_DATA24, CYREG_SCB1_EZ_DATA24
.set PSOC5_SCB__EZ_DATA25, CYREG_SCB1_EZ_DATA25
.set PSOC5_SCB__EZ_DATA26, CYREG_SCB1_EZ_DATA26
.set PSOC5_SCB__EZ_DATA27, CYREG_SCB1_EZ_DATA27
.set PSOC5_SCB__EZ_DATA28, CYREG_SCB1_EZ_DATA28
.set PSOC5_SCB__EZ_DATA29, CYREG_SCB1_EZ_DATA29
.set PSOC5_SCB__EZ_DATA30, CYREG_SCB1_EZ_DATA30
.set PSOC5_SCB__EZ_DATA31, CYREG_SCB1_EZ_DATA31
.set PSOC5_SCB__I2C_CFG, CYREG_SCB1_I2C_CFG
.set PSOC5_SCB__I2C_CTRL, CYREG_SCB1_I2C_CTRL
.set PSOC5_SCB__I2C_M_CMD, CYREG_SCB1_I2C_M_CMD
.set PSOC5_SCB__I2C_STATUS, CYREG_SCB1_I2C_STATUS
.set PSOC5_SCB__I2C_S_CMD, CYREG_SCB1_I2C_S_CMD
.set PSOC5_SCB__INTR_CAUSE, CYREG_SCB1_INTR_CAUSE
.set PSOC5_SCB__INTR_I2C_EC, CYREG_SCB1_INTR_I2C_EC
.set PSOC5_SCB__INTR_I2C_EC_MASK, CYREG_SCB1_INTR_I2C_EC_MASK
.set PSOC5_SCB__INTR_I2C_EC_MASKED, CYREG_SCB1_INTR_I2C_EC_MASKED
.set PSOC5_SCB__INTR_M, CYREG_SCB1_INTR_M
.set PSOC5_SCB__INTR_M_MASK, CYREG_SCB1_INTR_M_MASK
.set PSOC5_SCB__INTR_M_MASKED, CYREG_SCB1_INTR_M_MASKED
.set PSOC5_SCB__INTR_M_SET, CYREG_SCB1_INTR_M_SET
.set PSOC5_SCB__INTR_RX, CYREG_SCB1_INTR_RX
.set PSOC5_SCB__INTR_RX_MASK, CYREG_SCB1_INTR_RX_MASK
.set PSOC5_SCB__INTR_RX_MASKED, CYREG_SCB1_INTR_RX_MASKED
.set PSOC5_SCB__INTR_RX_SET, CYREG_SCB1_INTR_RX_SET
.set PSOC5_SCB__INTR_S, CYREG_SCB1_INTR_S
.set PSOC5_SCB__INTR_SPI_EC, CYREG_SCB1_INTR_SPI_EC
.set PSOC5_SCB__INTR_SPI_EC_MASK, CYREG_SCB1_INTR_SPI_EC_MASK
.set PSOC5_SCB__INTR_SPI_EC_MASKED, CYREG_SCB1_INTR_SPI_EC_MASKED
.set PSOC5_SCB__INTR_S_MASK, CYREG_SCB1_INTR_S_MASK
.set PSOC5_SCB__INTR_S_MASKED, CYREG_SCB1_INTR_S_MASKED
.set PSOC5_SCB__INTR_S_SET, CYREG_SCB1_INTR_S_SET
.set PSOC5_SCB__INTR_TX, CYREG_SCB1_INTR_TX
.set PSOC5_SCB__INTR_TX_MASK, CYREG_SCB1_INTR_TX_MASK
.set PSOC5_SCB__INTR_TX_MASKED, CYREG_SCB1_INTR_TX_MASKED
.set PSOC5_SCB__INTR_TX_SET, CYREG_SCB1_INTR_TX_SET
.set PSOC5_SCB__RX_CTRL, CYREG_SCB1_RX_CTRL
.set PSOC5_SCB__RX_FIFO_CTRL, CYREG_SCB1_RX_FIFO_CTRL
.set PSOC5_SCB__RX_FIFO_RD, CYREG_SCB1_RX_FIFO_RD
.set PSOC5_SCB__RX_FIFO_RD_SILENT, CYREG_SCB1_RX_FIFO_RD_SILENT
.set PSOC5_SCB__RX_FIFO_STATUS, CYREG_SCB1_RX_FIFO_STATUS
.set PSOC5_SCB__RX_MATCH, CYREG_SCB1_RX_MATCH
.set PSOC5_SCB__SPI_CTRL, CYREG_SCB1_SPI_CTRL
.set PSOC5_SCB__SPI_STATUS, CYREG_SCB1_SPI_STATUS
.set PSOC5_SCB__STATUS, CYREG_SCB1_STATUS
.set PSOC5_SCB__TX_CTRL, CYREG_SCB1_TX_CTRL
.set PSOC5_SCB__TX_FIFO_CTRL, CYREG_SCB1_TX_FIFO_CTRL
.set PSOC5_SCB__TX_FIFO_STATUS, CYREG_SCB1_TX_FIFO_STATUS
.set PSOC5_SCB__TX_FIFO_WR, CYREG_SCB1_TX_FIFO_WR
.set PSOC5_SCB__UART_CTRL, CYREG_SCB1_UART_CTRL
.set PSOC5_SCB__UART_RX_CTRL, CYREG_SCB1_UART_RX_CTRL
.set PSOC5_SCB__UART_RX_STATUS, CYREG_SCB1_UART_RX_STATUS
.set PSOC5_SCB__UART_TX_CTRL, CYREG_SCB1_UART_TX_CTRL

/* PSOC5_rx */
.set PSOC5_rx__0__DM__MASK, 0x07
.set PSOC5_rx__0__DM__SHIFT, 0
.set PSOC5_rx__0__DR, CYREG_PRT3_DR
.set PSOC5_rx__0__HSIOM, CYREG_HSIOM_PORT_SEL3
.set PSOC5_rx__0__HSIOM_MASK, 0x0000000F
.set PSOC5_rx__0__HSIOM_SHIFT, 0
.set PSOC5_rx__0__INTCFG, CYREG_PRT3_INTCFG
.set PSOC5_rx__0__INTSTAT, CYREG_PRT3_INTSTAT
.set PSOC5_rx__0__MASK, 0x01
.set PSOC5_rx__0__PA__CFG0, CYREG_UDB_PA3_CFG0
.set PSOC5_rx__0__PA__CFG1, CYREG_UDB_PA3_CFG1
.set PSOC5_rx__0__PA__CFG10, CYREG_UDB_PA3_CFG10
.set PSOC5_rx__0__PA__CFG11, CYREG_UDB_PA3_CFG11
.set PSOC5_rx__0__PA__CFG12, CYREG_UDB_PA3_CFG12
.set PSOC5_rx__0__PA__CFG13, CYREG_UDB_PA3_CFG13
.set PSOC5_rx__0__PA__CFG14, CYREG_UDB_PA3_CFG14
.set PSOC5_rx__0__PA__CFG2, CYREG_UDB_PA3_CFG2
.set PSOC5_rx__0__PA__CFG3, CYREG_UDB_PA3_CFG3
.set PSOC5_rx__0__PA__CFG4, CYREG_UDB_PA3_CFG4
.set PSOC5_rx__0__PA__CFG5, CYREG_UDB_PA3_CFG5
.set PSOC5_rx__0__PA__CFG6, CYREG_UDB_PA3_CFG6
.set PSOC5_rx__0__PA__CFG7, CYREG_UDB_PA3_CFG7
.set PSOC5_rx__0__PA__CFG8, CYREG_UDB_PA3_CFG8
.set PSOC5_rx__0__PA__CFG9, CYREG_UDB_PA3_CFG9
.set PSOC5_rx__0__PC, CYREG_PRT3_PC
.set PSOC5_rx__0__PC2, CYREG_PRT3_PC2
.set PSOC5_rx__0__PORT, 3
.set PSOC5_rx__0__PS, CYREG_PRT3_PS
.set PSOC5_rx__0__SHIFT, 0
.set PSOC5_rx__DR, CYREG_PRT3_DR
.set PSOC5_rx__INTCFG, CYREG_PRT3_INTCFG
.set PSOC5_rx__INTSTAT, CYREG_PRT3_INTSTAT
.set PSOC5_rx__MASK, 0x01
.set PSOC5_rx__PA__CFG0, CYREG_UDB_PA3_CFG0
.set PSOC5_rx__PA__CFG1, CYREG_UDB_PA3_CFG1
.set PSOC5_rx__PA__CFG10, CYREG_UDB_PA3_CFG10
.set PSOC5_rx__PA__CFG11, CYREG_UDB_PA3_CFG11
.set PSOC5_rx__PA__CFG12, CYREG_UDB_PA3_CFG12
.set PSOC5_rx__PA__CFG13, CYREG_UDB_PA3_CFG13
.set PSOC5_rx__PA__CFG14, CYREG_UDB_PA3_CFG14
.set PSOC5_rx__PA__CFG2, CYREG_UDB_PA3_CFG2
.set PSOC5_rx__PA__CFG3, CYREG_UDB_PA3_CFG3
.set PSOC5_rx__PA__CFG4, CYREG_UDB_PA3_CFG4
.set PSOC5_rx__PA__CFG5, CYREG_UDB_PA3_CFG5
.set PSOC5_rx__PA__CFG6, CYREG_UDB_PA3_CFG6
.set PSOC5_rx__PA__CFG7, CYREG_UDB_PA3_CFG7
.set PSOC5_rx__PA__CFG8, CYREG_UDB_PA3_CFG8
.set PSOC5_rx__PA__CFG9, CYREG_UDB_PA3_CFG9
.set PSOC5_rx__PC, CYREG_PRT3_PC
.set PSOC5_rx__PC2, CYREG_PRT3_PC2
.set PSOC5_rx__PORT, 3
.set PSOC5_rx__PS, CYREG_PRT3_PS
.set PSOC5_rx__SHIFT, 0

/* PSOC5_tx */
.set PSOC5_tx__0__DM__MASK, 0x38
.set PSOC5_tx__0__DM__SHIFT, 3
.set PSOC5_tx__0__DR, CYREG_PRT3_DR
.set PSOC5_tx__0__HSIOM, CYREG_HSIOM_PORT_SEL3
.set PSOC5_tx__0__HSIOM_MASK, 0x000000F0
.set PSOC5_tx__0__HSIOM_SHIFT, 4
.set PSOC5_tx__0__INTCFG, CYREG_PRT3_INTCFG
.set PSOC5_tx__0__INTSTAT, CYREG_PRT3_INTSTAT
.set PSOC5_tx__0__MASK, 0x02
.set PSOC5_tx__0__OUT_SEL, CYREG_UDB_PA3_CFG10
.set PSOC5_tx__0__OUT_SEL_SHIFT, 2
.set PSOC5_tx__0__OUT_SEL_VAL, -1
.set PSOC5_tx__0__PA__CFG0, CYREG_UDB_PA3_CFG0
.set PSOC5_tx__0__PA__CFG1, CYREG_UDB_PA3_CFG1
.set PSOC5_tx__0__PA__CFG10, CYREG_UDB_PA3_CFG10
.set PSOC5_tx__0__PA__CFG11, CYREG_UDB_PA3_CFG11
.set PSOC5_tx__0__PA__CFG12, CYREG_UDB_PA3_CFG12
.set PSOC5_tx__0__PA__CFG13, CYREG_UDB_PA3_CFG13
.set PSOC5_tx__0__PA__CFG14, CYREG_UDB_PA3_CFG14
.set PSOC5_tx__0__PA__CFG2, CYREG_UDB_PA3_CFG2
.set PSOC5_tx__0__PA__CFG3, CYREG_UDB_PA3_CFG3
.set PSOC5_tx__0__PA__CFG4, CYREG_UDB_PA3_CFG4
.set PSOC5_tx__0__PA__CFG5, CYREG_UDB_PA3_CFG5
.set PSOC5_tx__0__PA__CFG6, CYREG_UDB_PA3_CFG6
.set PSOC5_tx__0__PA__CFG7, CYREG_UDB_PA3_CFG7
.set PSOC5_tx__0__PA__CFG8, CYREG_UDB_PA3_CFG8
.set PSOC5_tx__0__PA__CFG9, CYREG_UDB_PA3_CFG9
.set PSOC5_tx__0__PC, CYREG_PRT3_PC
.set PSOC5_tx__0__PC2, CYREG_PRT3_PC2
.set PSOC5_tx__0__PORT, 3
.set PSOC5_tx__0__PS, CYREG_PRT3_PS
.set PSOC5_tx__0__SHIFT, 1
.set PSOC5_tx__DR, CYREG_PRT3_DR
.set PSOC5_tx__INTCFG, CYREG_PRT3_INTCFG
.set PSOC5_tx__INTSTAT, CYREG_PRT3_INTSTAT
.set PSOC5_tx__MASK, 0x02
.set PSOC5_tx__PA__CFG0, CYREG_UDB_PA3_CFG0
.set PSOC5_tx__PA__CFG1, CYREG_UDB_PA3_CFG1
.set PSOC5_tx__PA__CFG10, CYREG_UDB_PA3_CFG10
.set PSOC5_tx__PA__CFG11, CYREG_UDB_PA3_CFG11
.set PSOC5_tx__PA__CFG12, CYREG_UDB_PA3_CFG12
.set PSOC5_tx__PA__CFG13, CYREG_UDB_PA3_CFG13
.set PSOC5_tx__PA__CFG14, CYREG_UDB_PA3_CFG14
.set PSOC5_tx__PA__CFG2, CYREG_UDB_PA3_CFG2
.set PSOC5_tx__PA__CFG3, CYREG_UDB_PA3_CFG3
.set PSOC5_tx__PA__CFG4, CYREG_UDB_PA3_CFG4
.set PSOC5_tx__PA__CFG5, CYREG_UDB_PA3_CFG5
.set PSOC5_tx__PA__CFG6, CYREG_UDB_PA3_CFG6
.set PSOC5_tx__PA__CFG7, CYREG_UDB_PA3_CFG7
.set PSOC5_tx__PA__CFG8, CYREG_UDB_PA3_CFG8
.set PSOC5_tx__PA__CFG9, CYREG_UDB_PA3_CFG9
.set PSOC5_tx__PC, CYREG_PRT3_PC
.set PSOC5_tx__PC2, CYREG_PRT3_PC2
.set PSOC5_tx__PORT, 3
.set PSOC5_tx__PS, CYREG_PRT3_PS
.set PSOC5_tx__SHIFT, 1

/* Blue_Rx */
.set Blue_Rx__0__DM__MASK, 0x7000
.set Blue_Rx__0__DM__SHIFT, 12
.set Blue_Rx__0__DR, CYREG_PRT0_DR
.set Blue_Rx__0__HSIOM, CYREG_HSIOM_PORT_SEL0
.set Blue_Rx__0__HSIOM_MASK, 0x000F0000
.set Blue_Rx__0__HSIOM_SHIFT, 16
.set Blue_Rx__0__INTCFG, CYREG_PRT0_INTCFG
.set Blue_Rx__0__INTSTAT, CYREG_PRT0_INTSTAT
.set Blue_Rx__0__MASK, 0x10
.set Blue_Rx__0__PA__CFG0, CYREG_UDB_PA0_CFG0
.set Blue_Rx__0__PA__CFG1, CYREG_UDB_PA0_CFG1
.set Blue_Rx__0__PA__CFG10, CYREG_UDB_PA0_CFG10
.set Blue_Rx__0__PA__CFG11, CYREG_UDB_PA0_CFG11
.set Blue_Rx__0__PA__CFG12, CYREG_UDB_PA0_CFG12
.set Blue_Rx__0__PA__CFG13, CYREG_UDB_PA0_CFG13
.set Blue_Rx__0__PA__CFG14, CYREG_UDB_PA0_CFG14
.set Blue_Rx__0__PA__CFG2, CYREG_UDB_PA0_CFG2
.set Blue_Rx__0__PA__CFG3, CYREG_UDB_PA0_CFG3
.set Blue_Rx__0__PA__CFG4, CYREG_UDB_PA0_CFG4
.set Blue_Rx__0__PA__CFG5, CYREG_UDB_PA0_CFG5
.set Blue_Rx__0__PA__CFG6, CYREG_UDB_PA0_CFG6
.set Blue_Rx__0__PA__CFG7, CYREG_UDB_PA0_CFG7
.set Blue_Rx__0__PA__CFG8, CYREG_UDB_PA0_CFG8
.set Blue_Rx__0__PA__CFG9, CYREG_UDB_PA0_CFG9
.set Blue_Rx__0__PC, CYREG_PRT0_PC
.set Blue_Rx__0__PC2, CYREG_PRT0_PC2
.set Blue_Rx__0__PORT, 0
.set Blue_Rx__0__PS, CYREG_PRT0_PS
.set Blue_Rx__0__SHIFT, 4
.set Blue_Rx__DR, CYREG_PRT0_DR
.set Blue_Rx__INTCFG, CYREG_PRT0_INTCFG
.set Blue_Rx__INTSTAT, CYREG_PRT0_INTSTAT
.set Blue_Rx__MASK, 0x10
.set Blue_Rx__PA__CFG0, CYREG_UDB_PA0_CFG0
.set Blue_Rx__PA__CFG1, CYREG_UDB_PA0_CFG1
.set Blue_Rx__PA__CFG10, CYREG_UDB_PA0_CFG10
.set Blue_Rx__PA__CFG11, CYREG_UDB_PA0_CFG11
.set Blue_Rx__PA__CFG12, CYREG_UDB_PA0_CFG12
.set Blue_Rx__PA__CFG13, CYREG_UDB_PA0_CFG13
.set Blue_Rx__PA__CFG14, CYREG_UDB_PA0_CFG14
.set Blue_Rx__PA__CFG2, CYREG_UDB_PA0_CFG2
.set Blue_Rx__PA__CFG3, CYREG_UDB_PA0_CFG3
.set Blue_Rx__PA__CFG4, CYREG_UDB_PA0_CFG4
.set Blue_Rx__PA__CFG5, CYREG_UDB_PA0_CFG5
.set Blue_Rx__PA__CFG6, CYREG_UDB_PA0_CFG6
.set Blue_Rx__PA__CFG7, CYREG_UDB_PA0_CFG7
.set Blue_Rx__PA__CFG8, CYREG_UDB_PA0_CFG8
.set Blue_Rx__PA__CFG9, CYREG_UDB_PA0_CFG9
.set Blue_Rx__PC, CYREG_PRT0_PC
.set Blue_Rx__PC2, CYREG_PRT0_PC2
.set Blue_Rx__PORT, 0
.set Blue_Rx__PS, CYREG_PRT0_PS
.set Blue_Rx__SHIFT, 4

/* Blue_Tx */
.set Blue_Tx__0__DM__MASK, 0x38000
.set Blue_Tx__0__DM__SHIFT, 15
.set Blue_Tx__0__DR, CYREG_PRT0_DR
.set Blue_Tx__0__HSIOM, CYREG_HSIOM_PORT_SEL0
.set Blue_Tx__0__HSIOM_MASK, 0x00F00000
.set Blue_Tx__0__HSIOM_SHIFT, 20
.set Blue_Tx__0__INTCFG, CYREG_PRT0_INTCFG
.set Blue_Tx__0__INTSTAT, CYREG_PRT0_INTSTAT
.set Blue_Tx__0__MASK, 0x20
.set Blue_Tx__0__OUT_SEL, CYREG_UDB_PA0_CFG10
.set Blue_Tx__0__OUT_SEL_SHIFT, 10
.set Blue_Tx__0__OUT_SEL_VAL, 2
.set Blue_Tx__0__PA__CFG0, CYREG_UDB_PA0_CFG0
.set Blue_Tx__0__PA__CFG1, CYREG_UDB_PA0_CFG1
.set Blue_Tx__0__PA__CFG10, CYREG_UDB_PA0_CFG10
.set Blue_Tx__0__PA__CFG11, CYREG_UDB_PA0_CFG11
.set Blue_Tx__0__PA__CFG12, CYREG_UDB_PA0_CFG12
.set Blue_Tx__0__PA__CFG13, CYREG_UDB_PA0_CFG13
.set Blue_Tx__0__PA__CFG14, CYREG_UDB_PA0_CFG14
.set Blue_Tx__0__PA__CFG2, CYREG_UDB_PA0_CFG2
.set Blue_Tx__0__PA__CFG3, CYREG_UDB_PA0_CFG3
.set Blue_Tx__0__PA__CFG4, CYREG_UDB_PA0_CFG4
.set Blue_Tx__0__PA__CFG5, CYREG_UDB_PA0_CFG5
.set Blue_Tx__0__PA__CFG6, CYREG_UDB_PA0_CFG6
.set Blue_Tx__0__PA__CFG7, CYREG_UDB_PA0_CFG7
.set Blue_Tx__0__PA__CFG8, CYREG_UDB_PA0_CFG8
.set Blue_Tx__0__PA__CFG9, CYREG_UDB_PA0_CFG9
.set Blue_Tx__0__PC, CYREG_PRT0_PC
.set Blue_Tx__0__PC2, CYREG_PRT0_PC2
.set Blue_Tx__0__PORT, 0
.set Blue_Tx__0__PS, CYREG_PRT0_PS
.set Blue_Tx__0__SHIFT, 5
.set Blue_Tx__DR, CYREG_PRT0_DR
.set Blue_Tx__INTCFG, CYREG_PRT0_INTCFG
.set Blue_Tx__INTSTAT, CYREG_PRT0_INTSTAT
.set Blue_Tx__MASK, 0x20
.set Blue_Tx__PA__CFG0, CYREG_UDB_PA0_CFG0
.set Blue_Tx__PA__CFG1, CYREG_UDB_PA0_CFG1
.set Blue_Tx__PA__CFG10, CYREG_UDB_PA0_CFG10
.set Blue_Tx__PA__CFG11, CYREG_UDB_PA0_CFG11
.set Blue_Tx__PA__CFG12, CYREG_UDB_PA0_CFG12
.set Blue_Tx__PA__CFG13, CYREG_UDB_PA0_CFG13
.set Blue_Tx__PA__CFG14, CYREG_UDB_PA0_CFG14
.set Blue_Tx__PA__CFG2, CYREG_UDB_PA0_CFG2
.set Blue_Tx__PA__CFG3, CYREG_UDB_PA0_CFG3
.set Blue_Tx__PA__CFG4, CYREG_UDB_PA0_CFG4
.set Blue_Tx__PA__CFG5, CYREG_UDB_PA0_CFG5
.set Blue_Tx__PA__CFG6, CYREG_UDB_PA0_CFG6
.set Blue_Tx__PA__CFG7, CYREG_UDB_PA0_CFG7
.set Blue_Tx__PA__CFG8, CYREG_UDB_PA0_CFG8
.set Blue_Tx__PA__CFG9, CYREG_UDB_PA0_CFG9
.set Blue_Tx__PC, CYREG_PRT0_PC
.set Blue_Tx__PC2, CYREG_PRT0_PC2
.set Blue_Tx__PORT, 0
.set Blue_Tx__PS, CYREG_PRT0_PS
.set Blue_Tx__SHIFT, 5

/* Vin_Y */
.set Vin_Y__0__DM__MASK, 0x38
.set Vin_Y__0__DM__SHIFT, 3
.set Vin_Y__0__DR, CYREG_PRT2_DR
.set Vin_Y__0__HSIOM, CYREG_HSIOM_PORT_SEL2
.set Vin_Y__0__HSIOM_MASK, 0x000000F0
.set Vin_Y__0__HSIOM_SHIFT, 4
.set Vin_Y__0__INTCFG, CYREG_PRT2_INTCFG
.set Vin_Y__0__INTSTAT, CYREG_PRT2_INTSTAT
.set Vin_Y__0__MASK, 0x02
.set Vin_Y__0__PA__CFG0, CYREG_UDB_PA2_CFG0
.set Vin_Y__0__PA__CFG1, CYREG_UDB_PA2_CFG1
.set Vin_Y__0__PA__CFG10, CYREG_UDB_PA2_CFG10
.set Vin_Y__0__PA__CFG11, CYREG_UDB_PA2_CFG11
.set Vin_Y__0__PA__CFG12, CYREG_UDB_PA2_CFG12
.set Vin_Y__0__PA__CFG13, CYREG_UDB_PA2_CFG13
.set Vin_Y__0__PA__CFG14, CYREG_UDB_PA2_CFG14
.set Vin_Y__0__PA__CFG2, CYREG_UDB_PA2_CFG2
.set Vin_Y__0__PA__CFG3, CYREG_UDB_PA2_CFG3
.set Vin_Y__0__PA__CFG4, CYREG_UDB_PA2_CFG4
.set Vin_Y__0__PA__CFG5, CYREG_UDB_PA2_CFG5
.set Vin_Y__0__PA__CFG6, CYREG_UDB_PA2_CFG6
.set Vin_Y__0__PA__CFG7, CYREG_UDB_PA2_CFG7
.set Vin_Y__0__PA__CFG8, CYREG_UDB_PA2_CFG8
.set Vin_Y__0__PA__CFG9, CYREG_UDB_PA2_CFG9
.set Vin_Y__0__PC, CYREG_PRT2_PC
.set Vin_Y__0__PC2, CYREG_PRT2_PC2
.set Vin_Y__0__PORT, 2
.set Vin_Y__0__PS, CYREG_PRT2_PS
.set Vin_Y__0__SHIFT, 1
.set Vin_Y__DR, CYREG_PRT2_DR
.set Vin_Y__INTCFG, CYREG_PRT2_INTCFG
.set Vin_Y__INTSTAT, CYREG_PRT2_INTSTAT
.set Vin_Y__MASK, 0x02
.set Vin_Y__PA__CFG0, CYREG_UDB_PA2_CFG0
.set Vin_Y__PA__CFG1, CYREG_UDB_PA2_CFG1
.set Vin_Y__PA__CFG10, CYREG_UDB_PA2_CFG10
.set Vin_Y__PA__CFG11, CYREG_UDB_PA2_CFG11
.set Vin_Y__PA__CFG12, CYREG_UDB_PA2_CFG12
.set Vin_Y__PA__CFG13, CYREG_UDB_PA2_CFG13
.set Vin_Y__PA__CFG14, CYREG_UDB_PA2_CFG14
.set Vin_Y__PA__CFG2, CYREG_UDB_PA2_CFG2
.set Vin_Y__PA__CFG3, CYREG_UDB_PA2_CFG3
.set Vin_Y__PA__CFG4, CYREG_UDB_PA2_CFG4
.set Vin_Y__PA__CFG5, CYREG_UDB_PA2_CFG5
.set Vin_Y__PA__CFG6, CYREG_UDB_PA2_CFG6
.set Vin_Y__PA__CFG7, CYREG_UDB_PA2_CFG7
.set Vin_Y__PA__CFG8, CYREG_UDB_PA2_CFG8
.set Vin_Y__PA__CFG9, CYREG_UDB_PA2_CFG9
.set Vin_Y__PC, CYREG_PRT2_PC
.set Vin_Y__PC2, CYREG_PRT2_PC2
.set Vin_Y__PORT, 2
.set Vin_Y__PS, CYREG_PRT2_PS
.set Vin_Y__SHIFT, 1

/* Vin_Z */
.set Vin_Z__0__DM__MASK, 0x07
.set Vin_Z__0__DM__SHIFT, 0
.set Vin_Z__0__DR, CYREG_PRT2_DR
.set Vin_Z__0__HSIOM, CYREG_HSIOM_PORT_SEL2
.set Vin_Z__0__HSIOM_MASK, 0x0000000F
.set Vin_Z__0__HSIOM_SHIFT, 0
.set Vin_Z__0__INTCFG, CYREG_PRT2_INTCFG
.set Vin_Z__0__INTSTAT, CYREG_PRT2_INTSTAT
.set Vin_Z__0__MASK, 0x01
.set Vin_Z__0__PA__CFG0, CYREG_UDB_PA2_CFG0
.set Vin_Z__0__PA__CFG1, CYREG_UDB_PA2_CFG1
.set Vin_Z__0__PA__CFG10, CYREG_UDB_PA2_CFG10
.set Vin_Z__0__PA__CFG11, CYREG_UDB_PA2_CFG11
.set Vin_Z__0__PA__CFG12, CYREG_UDB_PA2_CFG12
.set Vin_Z__0__PA__CFG13, CYREG_UDB_PA2_CFG13
.set Vin_Z__0__PA__CFG14, CYREG_UDB_PA2_CFG14
.set Vin_Z__0__PA__CFG2, CYREG_UDB_PA2_CFG2
.set Vin_Z__0__PA__CFG3, CYREG_UDB_PA2_CFG3
.set Vin_Z__0__PA__CFG4, CYREG_UDB_PA2_CFG4
.set Vin_Z__0__PA__CFG5, CYREG_UDB_PA2_CFG5
.set Vin_Z__0__PA__CFG6, CYREG_UDB_PA2_CFG6
.set Vin_Z__0__PA__CFG7, CYREG_UDB_PA2_CFG7
.set Vin_Z__0__PA__CFG8, CYREG_UDB_PA2_CFG8
.set Vin_Z__0__PA__CFG9, CYREG_UDB_PA2_CFG9
.set Vin_Z__0__PC, CYREG_PRT2_PC
.set Vin_Z__0__PC2, CYREG_PRT2_PC2
.set Vin_Z__0__PORT, 2
.set Vin_Z__0__PS, CYREG_PRT2_PS
.set Vin_Z__0__SHIFT, 0
.set Vin_Z__DR, CYREG_PRT2_DR
.set Vin_Z__INTCFG, CYREG_PRT2_INTCFG
.set Vin_Z__INTSTAT, CYREG_PRT2_INTSTAT
.set Vin_Z__MASK, 0x01
.set Vin_Z__PA__CFG0, CYREG_UDB_PA2_CFG0
.set Vin_Z__PA__CFG1, CYREG_UDB_PA2_CFG1
.set Vin_Z__PA__CFG10, CYREG_UDB_PA2_CFG10
.set Vin_Z__PA__CFG11, CYREG_UDB_PA2_CFG11
.set Vin_Z__PA__CFG12, CYREG_UDB_PA2_CFG12
.set Vin_Z__PA__CFG13, CYREG_UDB_PA2_CFG13
.set Vin_Z__PA__CFG14, CYREG_UDB_PA2_CFG14
.set Vin_Z__PA__CFG2, CYREG_UDB_PA2_CFG2
.set Vin_Z__PA__CFG3, CYREG_UDB_PA2_CFG3
.set Vin_Z__PA__CFG4, CYREG_UDB_PA2_CFG4
.set Vin_Z__PA__CFG5, CYREG_UDB_PA2_CFG5
.set Vin_Z__PA__CFG6, CYREG_UDB_PA2_CFG6
.set Vin_Z__PA__CFG7, CYREG_UDB_PA2_CFG7
.set Vin_Z__PA__CFG8, CYREG_UDB_PA2_CFG8
.set Vin_Z__PA__CFG9, CYREG_UDB_PA2_CFG9
.set Vin_Z__PC, CYREG_PRT2_PC
.set Vin_Z__PC2, CYREG_PRT2_PC2
.set Vin_Z__PORT, 2
.set Vin_Z__PS, CYREG_PRT2_PS
.set Vin_Z__SHIFT, 0

/* Vin */
.set Vin__0__DM__MASK, 0xE00
.set Vin__0__DM__SHIFT, 9
.set Vin__0__DR, CYREG_PRT2_DR
.set Vin__0__HSIOM, CYREG_HSIOM_PORT_SEL2
.set Vin__0__HSIOM_MASK, 0x0000F000
.set Vin__0__HSIOM_SHIFT, 12
.set Vin__0__INTCFG, CYREG_PRT2_INTCFG
.set Vin__0__INTSTAT, CYREG_PRT2_INTSTAT
.set Vin__0__MASK, 0x08
.set Vin__0__PA__CFG0, CYREG_UDB_PA2_CFG0
.set Vin__0__PA__CFG1, CYREG_UDB_PA2_CFG1
.set Vin__0__PA__CFG10, CYREG_UDB_PA2_CFG10
.set Vin__0__PA__CFG11, CYREG_UDB_PA2_CFG11
.set Vin__0__PA__CFG12, CYREG_UDB_PA2_CFG12
.set Vin__0__PA__CFG13, CYREG_UDB_PA2_CFG13
.set Vin__0__PA__CFG14, CYREG_UDB_PA2_CFG14
.set Vin__0__PA__CFG2, CYREG_UDB_PA2_CFG2
.set Vin__0__PA__CFG3, CYREG_UDB_PA2_CFG3
.set Vin__0__PA__CFG4, CYREG_UDB_PA2_CFG4
.set Vin__0__PA__CFG5, CYREG_UDB_PA2_CFG5
.set Vin__0__PA__CFG6, CYREG_UDB_PA2_CFG6
.set Vin__0__PA__CFG7, CYREG_UDB_PA2_CFG7
.set Vin__0__PA__CFG8, CYREG_UDB_PA2_CFG8
.set Vin__0__PA__CFG9, CYREG_UDB_PA2_CFG9
.set Vin__0__PC, CYREG_PRT2_PC
.set Vin__0__PC2, CYREG_PRT2_PC2
.set Vin__0__PORT, 2
.set Vin__0__PS, CYREG_PRT2_PS
.set Vin__0__SHIFT, 3
.set Vin__DR, CYREG_PRT2_DR
.set Vin__INTCFG, CYREG_PRT2_INTCFG
.set Vin__INTSTAT, CYREG_PRT2_INTSTAT
.set Vin__MASK, 0x08
.set Vin__PA__CFG0, CYREG_UDB_PA2_CFG0
.set Vin__PA__CFG1, CYREG_UDB_PA2_CFG1
.set Vin__PA__CFG10, CYREG_UDB_PA2_CFG10
.set Vin__PA__CFG11, CYREG_UDB_PA2_CFG11
.set Vin__PA__CFG12, CYREG_UDB_PA2_CFG12
.set Vin__PA__CFG13, CYREG_UDB_PA2_CFG13
.set Vin__PA__CFG14, CYREG_UDB_PA2_CFG14
.set Vin__PA__CFG2, CYREG_UDB_PA2_CFG2
.set Vin__PA__CFG3, CYREG_UDB_PA2_CFG3
.set Vin__PA__CFG4, CYREG_UDB_PA2_CFG4
.set Vin__PA__CFG5, CYREG_UDB_PA2_CFG5
.set Vin__PA__CFG6, CYREG_UDB_PA2_CFG6
.set Vin__PA__CFG7, CYREG_UDB_PA2_CFG7
.set Vin__PA__CFG8, CYREG_UDB_PA2_CFG8
.set Vin__PA__CFG9, CYREG_UDB_PA2_CFG9
.set Vin__PC, CYREG_PRT2_PC
.set Vin__PC2, CYREG_PRT2_PC2
.set Vin__PORT, 2
.set Vin__PS, CYREG_PRT2_PS
.set Vin__SHIFT, 3

/* Miscellaneous */
/* -- WARNING: define names containing LEOPARD or PANTHER are deprecated and will be removed in a future release */
.set CYDEV_DEBUG_PROTECT_OPEN, 1
.set CYDEV_DEBUGGING_DPS_SWD, 2
.set CYDEV_CONFIG_UNUSED_IO_AllowButWarn, 0
.set CYDEV_CONFIGURATION_MODE_COMPRESSED, 0
.set CYDEV_CHIP_REV_PSOC4A_PRODUCTION, 17
.set CYDEV_CHIP_REVISION_4A_PRODUCTION, 17
.set CYDEV_CHIP_MEMBER_4A, 2
.set CYDEV_CHIP_FAMILY_PSOC4, 2
.set CYDEV_CHIP_DIE_PSOC4A, 2
.set CYDEV_CHIP_DIE_EXPECT, CYDEV_CHIP_DIE_PSOC4A
.set CYDEV_BCLK__HFCLK__HZ, 24000000
.set CYDEV_BCLK__HFCLK__KHZ, 24000
.set CYDEV_BCLK__HFCLK__MHZ, 24
.set CYDEV_BCLK__SYSCLK__HZ, 24000000
.set CYDEV_BCLK__SYSCLK__KHZ, 24000
.set CYDEV_BCLK__SYSCLK__MHZ, 24
.set CYDEV_CHIP_DIE_ACTUAL, CYDEV_CHIP_DIE_EXPECT
.set CYDEV_CHIP_DIE_LEOPARD, 1
.set CYDEV_CHIP_DIE_PANTHER, 3
.set CYDEV_CHIP_DIE_PSOC5LP, 4
.set CYDEV_CHIP_DIE_UNKNOWN, 0
.set CYDEV_CHIP_FAMILY_PSOC3, 1
.set CYDEV_CHIP_FAMILY_PSOC5, 3
.set CYDEV_CHIP_FAMILY_UNKNOWN, 0
.set CYDEV_CHIP_FAMILY_USED, CYDEV_CHIP_FAMILY_PSOC4
.set CYDEV_CHIP_JTAG_ID, 0x04C81193
.set CYDEV_CHIP_MEMBER_3A, 1
.set CYDEV_CHIP_MEMBER_5A, 3
.set CYDEV_CHIP_MEMBER_5B, 4
.set CYDEV_CHIP_MEMBER_UNKNOWN, 0
.set CYDEV_CHIP_MEMBER_USED, CYDEV_CHIP_MEMBER_4A
.set CYDEV_CHIP_REVISION_3A_ES1, 0
.set CYDEV_CHIP_REVISION_3A_ES2, 1
.set CYDEV_CHIP_REVISION_3A_ES3, 3
.set CYDEV_CHIP_REVISION_3A_PRODUCTION, 3
.set CYDEV_CHIP_REVISION_4A_ES0, 17
.set CYDEV_CHIP_REVISION_5A_ES0, 0
.set CYDEV_CHIP_REVISION_5A_ES1, 1
.set CYDEV_CHIP_REVISION_5A_PRODUCTION, 1
.set CYDEV_CHIP_REVISION_5B_ES0, 0
.set CYDEV_CHIP_REVISION_5B_PRODUCTION, 0
.set CYDEV_CHIP_REVISION_USED, CYDEV_CHIP_REVISION_4A_PRODUCTION
.set CYDEV_CHIP_REV_EXPECT, CYDEV_CHIP_REV_PSOC4A_PRODUCTION
.set CYDEV_CHIP_REV_LEOPARD_ES1, 0
.set CYDEV_CHIP_REV_LEOPARD_ES2, 1
.set CYDEV_CHIP_REV_LEOPARD_ES3, 3
.set CYDEV_CHIP_REV_LEOPARD_PRODUCTION, 3
.set CYDEV_CHIP_REV_PANTHER_ES0, 0
.set CYDEV_CHIP_REV_PANTHER_ES1, 1
.set CYDEV_CHIP_REV_PANTHER_PRODUCTION, 1
.set CYDEV_CHIP_REV_PSOC4A_ES0, 17
.set CYDEV_CHIP_REV_PSOC5LP_ES0, 0
.set CYDEV_CHIP_REV_PSOC5LP_PRODUCTION, 0
.set CYDEV_CONFIGURATION_COMPRESSED, 1
.set CYDEV_CONFIGURATION_MODE, CYDEV_CONFIGURATION_MODE_COMPRESSED
.set CYDEV_CONFIGURATION_MODE_DMA, 2
.set CYDEV_CONFIGURATION_MODE_UNCOMPRESSED, 1
.set CYDEV_CONFIG_READ_ACCELERATOR, 1
.set CYDEV_CONFIG_UNUSED_IO, CYDEV_CONFIG_UNUSED_IO_AllowButWarn
.set CYDEV_CONFIG_UNUSED_IO_AllowWithInfo, 1
.set CYDEV_CONFIG_UNUSED_IO_Disallowed, 2
.set CYDEV_DEBUGGING_DPS, CYDEV_DEBUGGING_DPS_SWD
.set CYDEV_DEBUGGING_DPS_Disable, 3
.set CYDEV_DEBUGGING_ENABLE, 1
.set CYDEV_DEBUG_PROTECT, CYDEV_DEBUG_PROTECT_OPEN
.set CYDEV_DEBUG_PROTECT_KILL, 4
.set CYDEV_DEBUG_PROTECT_PROTECTED, 2
.set CYDEV_HEAP_SIZE, 0x0100
.set CYDEV_PROJ_TYPE, 0
.set CYDEV_PROJ_TYPE_BOOTLOADER, 1
.set CYDEV_PROJ_TYPE_LOADABLE, 2
.set CYDEV_PROJ_TYPE_MULTIAPPBOOTLOADER, 3
.set CYDEV_PROJ_TYPE_STANDARD, 0
.set CYDEV_STACK_SIZE, 0x0400
.set CYDEV_USE_BUNDLED_CMSIS, 1
.set CYDEV_VARIABLE_VDDA, 1
.set CYDEV_VDDA_MV, 3300
.set CYDEV_VDDD_MV, 3300
.set CYDEV_BOOTLOADER_ENABLE, 0
.endif
