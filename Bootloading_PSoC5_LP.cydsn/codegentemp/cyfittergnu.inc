.ifndef INCLUDED_CYFITTERGNU_INC
.set INCLUDED_CYFITTERGNU_INC, 1
.include "cydevicegnu.inc"
.include "cydevicegnu_trm.inc"

/* PSOC4_RXInternalInterrupt */
.set PSOC4_RXInternalInterrupt__INTC_CLR_EN_REG, CYREG_NVIC_CLRENA0
.set PSOC4_RXInternalInterrupt__INTC_CLR_PD_REG, CYREG_NVIC_CLRPEND0
.set PSOC4_RXInternalInterrupt__INTC_MASK, 0x02
.set PSOC4_RXInternalInterrupt__INTC_NUMBER, 1
.set PSOC4_RXInternalInterrupt__INTC_PRIOR_NUM, 7
.set PSOC4_RXInternalInterrupt__INTC_PRIOR_REG, CYREG_NVIC_PRI_1
.set PSOC4_RXInternalInterrupt__INTC_SET_EN_REG, CYREG_NVIC_SETENA0
.set PSOC4_RXInternalInterrupt__INTC_SET_PD_REG, CYREG_NVIC_SETPEND0

/* GPS_RXInternalInterrupt */
.set GPS_RXInternalInterrupt__INTC_CLR_EN_REG, CYREG_NVIC_CLRENA0
.set GPS_RXInternalInterrupt__INTC_CLR_PD_REG, CYREG_NVIC_CLRPEND0
.set GPS_RXInternalInterrupt__INTC_MASK, 0x01
.set GPS_RXInternalInterrupt__INTC_NUMBER, 0
.set GPS_RXInternalInterrupt__INTC_PRIOR_NUM, 7
.set GPS_RXInternalInterrupt__INTC_PRIOR_REG, CYREG_NVIC_PRI_0
.set GPS_RXInternalInterrupt__INTC_SET_EN_REG, CYREG_NVIC_SETENA0
.set GPS_RXInternalInterrupt__INTC_SET_PD_REG, CYREG_NVIC_SETPEND0

/* emFile_1_SPI0_BSPIM */
.set emFile_1_SPI0_BSPIM_BitCounter_ST__16BIT_STATUS_AUX_CTL_REG, CYREG_B0_UDB00_01_ACTL
.set emFile_1_SPI0_BSPIM_BitCounter_ST__16BIT_STATUS_REG, CYREG_B0_UDB00_01_ST
.set emFile_1_SPI0_BSPIM_BitCounter_ST__MASK_REG, CYREG_B0_UDB00_MSK
.set emFile_1_SPI0_BSPIM_BitCounter_ST__MASK_ST_AUX_CTL_REG, CYREG_B0_UDB00_MSK_ACTL
.set emFile_1_SPI0_BSPIM_BitCounter_ST__PER_ST_AUX_CTL_REG, CYREG_B0_UDB00_MSK_ACTL
.set emFile_1_SPI0_BSPIM_BitCounter_ST__STATUS_AUX_CTL_REG, CYREG_B0_UDB00_ACTL
.set emFile_1_SPI0_BSPIM_BitCounter_ST__STATUS_CNT_REG, CYREG_B0_UDB00_ST_CTL
.set emFile_1_SPI0_BSPIM_BitCounter_ST__STATUS_CONTROL_REG, CYREG_B0_UDB00_ST_CTL
.set emFile_1_SPI0_BSPIM_BitCounter_ST__STATUS_REG, CYREG_B0_UDB00_ST
.set emFile_1_SPI0_BSPIM_BitCounter__16BIT_CONTROL_AUX_CTL_REG, CYREG_B0_UDB00_01_ACTL
.set emFile_1_SPI0_BSPIM_BitCounter__16BIT_CONTROL_CONTROL_REG, CYREG_B0_UDB00_01_CTL
.set emFile_1_SPI0_BSPIM_BitCounter__16BIT_CONTROL_COUNT_REG, CYREG_B0_UDB00_01_CTL
.set emFile_1_SPI0_BSPIM_BitCounter__16BIT_COUNT_CONTROL_REG, CYREG_B0_UDB00_01_CTL
.set emFile_1_SPI0_BSPIM_BitCounter__16BIT_COUNT_COUNT_REG, CYREG_B0_UDB00_01_CTL
.set emFile_1_SPI0_BSPIM_BitCounter__16BIT_MASK_MASK_REG, CYREG_B0_UDB00_01_MSK
.set emFile_1_SPI0_BSPIM_BitCounter__16BIT_MASK_PERIOD_REG, CYREG_B0_UDB00_01_MSK
.set emFile_1_SPI0_BSPIM_BitCounter__16BIT_PERIOD_MASK_REG, CYREG_B0_UDB00_01_MSK
.set emFile_1_SPI0_BSPIM_BitCounter__16BIT_PERIOD_PERIOD_REG, CYREG_B0_UDB00_01_MSK
.set emFile_1_SPI0_BSPIM_BitCounter__CONTROL_AUX_CTL_REG, CYREG_B0_UDB00_ACTL
.set emFile_1_SPI0_BSPIM_BitCounter__CONTROL_REG, CYREG_B0_UDB00_CTL
.set emFile_1_SPI0_BSPIM_BitCounter__CONTROL_ST_REG, CYREG_B0_UDB00_ST_CTL
.set emFile_1_SPI0_BSPIM_BitCounter__COUNT_REG, CYREG_B0_UDB00_CTL
.set emFile_1_SPI0_BSPIM_BitCounter__COUNT_ST_REG, CYREG_B0_UDB00_ST_CTL
.set emFile_1_SPI0_BSPIM_BitCounter__MASK_CTL_AUX_CTL_REG, CYREG_B0_UDB00_MSK_ACTL
.set emFile_1_SPI0_BSPIM_BitCounter__PERIOD_REG, CYREG_B0_UDB00_MSK
.set emFile_1_SPI0_BSPIM_BitCounter__PER_CTL_AUX_CTL_REG, CYREG_B0_UDB00_MSK_ACTL
.set emFile_1_SPI0_BSPIM_RxStsReg__16BIT_STATUS_AUX_CTL_REG, CYREG_B0_UDB03_04_ACTL
.set emFile_1_SPI0_BSPIM_RxStsReg__16BIT_STATUS_REG, CYREG_B0_UDB03_04_ST
.set emFile_1_SPI0_BSPIM_RxStsReg__4__MASK, 0x10
.set emFile_1_SPI0_BSPIM_RxStsReg__4__POS, 4
.set emFile_1_SPI0_BSPIM_RxStsReg__5__MASK, 0x20
.set emFile_1_SPI0_BSPIM_RxStsReg__5__POS, 5
.set emFile_1_SPI0_BSPIM_RxStsReg__6__MASK, 0x40
.set emFile_1_SPI0_BSPIM_RxStsReg__6__POS, 6
.set emFile_1_SPI0_BSPIM_RxStsReg__MASK, 0x70
.set emFile_1_SPI0_BSPIM_RxStsReg__MASK_REG, CYREG_B0_UDB03_MSK
.set emFile_1_SPI0_BSPIM_RxStsReg__STATUS_AUX_CTL_REG, CYREG_B0_UDB03_ACTL
.set emFile_1_SPI0_BSPIM_RxStsReg__STATUS_REG, CYREG_B0_UDB03_ST
.set emFile_1_SPI0_BSPIM_TxStsReg__0__MASK, 0x01
.set emFile_1_SPI0_BSPIM_TxStsReg__0__POS, 0
.set emFile_1_SPI0_BSPIM_TxStsReg__16BIT_STATUS_AUX_CTL_REG, CYREG_B0_UDB02_03_ACTL
.set emFile_1_SPI0_BSPIM_TxStsReg__16BIT_STATUS_REG, CYREG_B0_UDB02_03_ST
.set emFile_1_SPI0_BSPIM_TxStsReg__1__MASK, 0x02
.set emFile_1_SPI0_BSPIM_TxStsReg__1__POS, 1
.set emFile_1_SPI0_BSPIM_TxStsReg__2__MASK, 0x04
.set emFile_1_SPI0_BSPIM_TxStsReg__2__POS, 2
.set emFile_1_SPI0_BSPIM_TxStsReg__3__MASK, 0x08
.set emFile_1_SPI0_BSPIM_TxStsReg__3__POS, 3
.set emFile_1_SPI0_BSPIM_TxStsReg__4__MASK, 0x10
.set emFile_1_SPI0_BSPIM_TxStsReg__4__POS, 4
.set emFile_1_SPI0_BSPIM_TxStsReg__MASK, 0x1F
.set emFile_1_SPI0_BSPIM_TxStsReg__MASK_REG, CYREG_B0_UDB02_MSK
.set emFile_1_SPI0_BSPIM_TxStsReg__STATUS_AUX_CTL_REG, CYREG_B0_UDB02_ACTL
.set emFile_1_SPI0_BSPIM_TxStsReg__STATUS_REG, CYREG_B0_UDB02_ST
.set emFile_1_SPI0_BSPIM_sR8_Dp_u0__16BIT_A0_REG, CYREG_B0_UDB02_03_A0
.set emFile_1_SPI0_BSPIM_sR8_Dp_u0__16BIT_A1_REG, CYREG_B0_UDB02_03_A1
.set emFile_1_SPI0_BSPIM_sR8_Dp_u0__16BIT_D0_REG, CYREG_B0_UDB02_03_D0
.set emFile_1_SPI0_BSPIM_sR8_Dp_u0__16BIT_D1_REG, CYREG_B0_UDB02_03_D1
.set emFile_1_SPI0_BSPIM_sR8_Dp_u0__16BIT_DP_AUX_CTL_REG, CYREG_B0_UDB02_03_ACTL
.set emFile_1_SPI0_BSPIM_sR8_Dp_u0__16BIT_F0_REG, CYREG_B0_UDB02_03_F0
.set emFile_1_SPI0_BSPIM_sR8_Dp_u0__16BIT_F1_REG, CYREG_B0_UDB02_03_F1
.set emFile_1_SPI0_BSPIM_sR8_Dp_u0__A0_A1_REG, CYREG_B0_UDB02_A0_A1
.set emFile_1_SPI0_BSPIM_sR8_Dp_u0__A0_REG, CYREG_B0_UDB02_A0
.set emFile_1_SPI0_BSPIM_sR8_Dp_u0__A1_REG, CYREG_B0_UDB02_A1
.set emFile_1_SPI0_BSPIM_sR8_Dp_u0__D0_D1_REG, CYREG_B0_UDB02_D0_D1
.set emFile_1_SPI0_BSPIM_sR8_Dp_u0__D0_REG, CYREG_B0_UDB02_D0
.set emFile_1_SPI0_BSPIM_sR8_Dp_u0__D1_REG, CYREG_B0_UDB02_D1
.set emFile_1_SPI0_BSPIM_sR8_Dp_u0__DP_AUX_CTL_REG, CYREG_B0_UDB02_ACTL
.set emFile_1_SPI0_BSPIM_sR8_Dp_u0__F0_F1_REG, CYREG_B0_UDB02_F0_F1
.set emFile_1_SPI0_BSPIM_sR8_Dp_u0__F0_REG, CYREG_B0_UDB02_F0
.set emFile_1_SPI0_BSPIM_sR8_Dp_u0__F1_REG, CYREG_B0_UDB02_F1

/* emFile_1_Clock_1 */
.set emFile_1_Clock_1__CFG0, CYREG_CLKDIST_DCFG0_CFG0
.set emFile_1_Clock_1__CFG1, CYREG_CLKDIST_DCFG0_CFG1
.set emFile_1_Clock_1__CFG2, CYREG_CLKDIST_DCFG0_CFG2
.set emFile_1_Clock_1__CFG2_SRC_SEL_MASK, 0x07
.set emFile_1_Clock_1__INDEX, 0x00
.set emFile_1_Clock_1__PM_ACT_CFG, CYREG_PM_ACT_CFG2
.set emFile_1_Clock_1__PM_ACT_MSK, 0x01
.set emFile_1_Clock_1__PM_STBY_CFG, CYREG_PM_STBY_CFG2
.set emFile_1_Clock_1__PM_STBY_MSK, 0x01

/* emFile_1_SPI0_CS */
.set emFile_1_SPI0_CS__0__MASK, 0x10
.set emFile_1_SPI0_CS__0__PC, CYREG_PRT3_PC4
.set emFile_1_SPI0_CS__0__PORT, 3
.set emFile_1_SPI0_CS__0__SHIFT, 4
.set emFile_1_SPI0_CS__AG, CYREG_PRT3_AG
.set emFile_1_SPI0_CS__AMUX, CYREG_PRT3_AMUX
.set emFile_1_SPI0_CS__BIE, CYREG_PRT3_BIE
.set emFile_1_SPI0_CS__BIT_MASK, CYREG_PRT3_BIT_MASK
.set emFile_1_SPI0_CS__BYP, CYREG_PRT3_BYP
.set emFile_1_SPI0_CS__CTL, CYREG_PRT3_CTL
.set emFile_1_SPI0_CS__DM0, CYREG_PRT3_DM0
.set emFile_1_SPI0_CS__DM1, CYREG_PRT3_DM1
.set emFile_1_SPI0_CS__DM2, CYREG_PRT3_DM2
.set emFile_1_SPI0_CS__DR, CYREG_PRT3_DR
.set emFile_1_SPI0_CS__INP_DIS, CYREG_PRT3_INP_DIS
.set emFile_1_SPI0_CS__LCD_COM_SEG, CYREG_PRT3_LCD_COM_SEG
.set emFile_1_SPI0_CS__LCD_EN, CYREG_PRT3_LCD_EN
.set emFile_1_SPI0_CS__MASK, 0x10
.set emFile_1_SPI0_CS__PORT, 3
.set emFile_1_SPI0_CS__PRT, CYREG_PRT3_PRT
.set emFile_1_SPI0_CS__PRTDSI__CAPS_SEL, CYREG_PRT3_CAPS_SEL
.set emFile_1_SPI0_CS__PRTDSI__DBL_SYNC_IN, CYREG_PRT3_DBL_SYNC_IN
.set emFile_1_SPI0_CS__PRTDSI__OE_SEL0, CYREG_PRT3_OE_SEL0
.set emFile_1_SPI0_CS__PRTDSI__OE_SEL1, CYREG_PRT3_OE_SEL1
.set emFile_1_SPI0_CS__PRTDSI__OUT_SEL0, CYREG_PRT3_OUT_SEL0
.set emFile_1_SPI0_CS__PRTDSI__OUT_SEL1, CYREG_PRT3_OUT_SEL1
.set emFile_1_SPI0_CS__PRTDSI__SYNC_OUT, CYREG_PRT3_SYNC_OUT
.set emFile_1_SPI0_CS__PS, CYREG_PRT3_PS
.set emFile_1_SPI0_CS__SHIFT, 4
.set emFile_1_SPI0_CS__SLW, CYREG_PRT3_SLW

/* emFile_1_miso0 */
.set emFile_1_miso0__0__MASK, 0x02
.set emFile_1_miso0__0__PC, CYREG_PRT0_PC1
.set emFile_1_miso0__0__PORT, 0
.set emFile_1_miso0__0__SHIFT, 1
.set emFile_1_miso0__AG, CYREG_PRT0_AG
.set emFile_1_miso0__AMUX, CYREG_PRT0_AMUX
.set emFile_1_miso0__BIE, CYREG_PRT0_BIE
.set emFile_1_miso0__BIT_MASK, CYREG_PRT0_BIT_MASK
.set emFile_1_miso0__BYP, CYREG_PRT0_BYP
.set emFile_1_miso0__CTL, CYREG_PRT0_CTL
.set emFile_1_miso0__DM0, CYREG_PRT0_DM0
.set emFile_1_miso0__DM1, CYREG_PRT0_DM1
.set emFile_1_miso0__DM2, CYREG_PRT0_DM2
.set emFile_1_miso0__DR, CYREG_PRT0_DR
.set emFile_1_miso0__INP_DIS, CYREG_PRT0_INP_DIS
.set emFile_1_miso0__LCD_COM_SEG, CYREG_PRT0_LCD_COM_SEG
.set emFile_1_miso0__LCD_EN, CYREG_PRT0_LCD_EN
.set emFile_1_miso0__MASK, 0x02
.set emFile_1_miso0__PORT, 0
.set emFile_1_miso0__PRT, CYREG_PRT0_PRT
.set emFile_1_miso0__PRTDSI__CAPS_SEL, CYREG_PRT0_CAPS_SEL
.set emFile_1_miso0__PRTDSI__DBL_SYNC_IN, CYREG_PRT0_DBL_SYNC_IN
.set emFile_1_miso0__PRTDSI__OE_SEL0, CYREG_PRT0_OE_SEL0
.set emFile_1_miso0__PRTDSI__OE_SEL1, CYREG_PRT0_OE_SEL1
.set emFile_1_miso0__PRTDSI__OUT_SEL0, CYREG_PRT0_OUT_SEL0
.set emFile_1_miso0__PRTDSI__OUT_SEL1, CYREG_PRT0_OUT_SEL1
.set emFile_1_miso0__PRTDSI__SYNC_OUT, CYREG_PRT0_SYNC_OUT
.set emFile_1_miso0__PS, CYREG_PRT0_PS
.set emFile_1_miso0__SHIFT, 1
.set emFile_1_miso0__SLW, CYREG_PRT0_SLW

/* emFile_1_mosi0 */
.set emFile_1_mosi0__0__MASK, 0x01
.set emFile_1_mosi0__0__PC, CYREG_PRT0_PC0
.set emFile_1_mosi0__0__PORT, 0
.set emFile_1_mosi0__0__SHIFT, 0
.set emFile_1_mosi0__AG, CYREG_PRT0_AG
.set emFile_1_mosi0__AMUX, CYREG_PRT0_AMUX
.set emFile_1_mosi0__BIE, CYREG_PRT0_BIE
.set emFile_1_mosi0__BIT_MASK, CYREG_PRT0_BIT_MASK
.set emFile_1_mosi0__BYP, CYREG_PRT0_BYP
.set emFile_1_mosi0__CTL, CYREG_PRT0_CTL
.set emFile_1_mosi0__DM0, CYREG_PRT0_DM0
.set emFile_1_mosi0__DM1, CYREG_PRT0_DM1
.set emFile_1_mosi0__DM2, CYREG_PRT0_DM2
.set emFile_1_mosi0__DR, CYREG_PRT0_DR
.set emFile_1_mosi0__INP_DIS, CYREG_PRT0_INP_DIS
.set emFile_1_mosi0__LCD_COM_SEG, CYREG_PRT0_LCD_COM_SEG
.set emFile_1_mosi0__LCD_EN, CYREG_PRT0_LCD_EN
.set emFile_1_mosi0__MASK, 0x01
.set emFile_1_mosi0__PORT, 0
.set emFile_1_mosi0__PRT, CYREG_PRT0_PRT
.set emFile_1_mosi0__PRTDSI__CAPS_SEL, CYREG_PRT0_CAPS_SEL
.set emFile_1_mosi0__PRTDSI__DBL_SYNC_IN, CYREG_PRT0_DBL_SYNC_IN
.set emFile_1_mosi0__PRTDSI__OE_SEL0, CYREG_PRT0_OE_SEL0
.set emFile_1_mosi0__PRTDSI__OE_SEL1, CYREG_PRT0_OE_SEL1
.set emFile_1_mosi0__PRTDSI__OUT_SEL0, CYREG_PRT0_OUT_SEL0
.set emFile_1_mosi0__PRTDSI__OUT_SEL1, CYREG_PRT0_OUT_SEL1
.set emFile_1_mosi0__PRTDSI__SYNC_OUT, CYREG_PRT0_SYNC_OUT
.set emFile_1_mosi0__PS, CYREG_PRT0_PS
.set emFile_1_mosi0__SHIFT, 0
.set emFile_1_mosi0__SLW, CYREG_PRT0_SLW

/* emFile_1_sclk0 */
.set emFile_1_sclk0__0__MASK, 0x20
.set emFile_1_sclk0__0__PC, CYREG_PRT3_PC5
.set emFile_1_sclk0__0__PORT, 3
.set emFile_1_sclk0__0__SHIFT, 5
.set emFile_1_sclk0__AG, CYREG_PRT3_AG
.set emFile_1_sclk0__AMUX, CYREG_PRT3_AMUX
.set emFile_1_sclk0__BIE, CYREG_PRT3_BIE
.set emFile_1_sclk0__BIT_MASK, CYREG_PRT3_BIT_MASK
.set emFile_1_sclk0__BYP, CYREG_PRT3_BYP
.set emFile_1_sclk0__CTL, CYREG_PRT3_CTL
.set emFile_1_sclk0__DM0, CYREG_PRT3_DM0
.set emFile_1_sclk0__DM1, CYREG_PRT3_DM1
.set emFile_1_sclk0__DM2, CYREG_PRT3_DM2
.set emFile_1_sclk0__DR, CYREG_PRT3_DR
.set emFile_1_sclk0__INP_DIS, CYREG_PRT3_INP_DIS
.set emFile_1_sclk0__LCD_COM_SEG, CYREG_PRT3_LCD_COM_SEG
.set emFile_1_sclk0__LCD_EN, CYREG_PRT3_LCD_EN
.set emFile_1_sclk0__MASK, 0x20
.set emFile_1_sclk0__PORT, 3
.set emFile_1_sclk0__PRT, CYREG_PRT3_PRT
.set emFile_1_sclk0__PRTDSI__CAPS_SEL, CYREG_PRT3_CAPS_SEL
.set emFile_1_sclk0__PRTDSI__DBL_SYNC_IN, CYREG_PRT3_DBL_SYNC_IN
.set emFile_1_sclk0__PRTDSI__OE_SEL0, CYREG_PRT3_OE_SEL0
.set emFile_1_sclk0__PRTDSI__OE_SEL1, CYREG_PRT3_OE_SEL1
.set emFile_1_sclk0__PRTDSI__OUT_SEL0, CYREG_PRT3_OUT_SEL0
.set emFile_1_sclk0__PRTDSI__OUT_SEL1, CYREG_PRT3_OUT_SEL1
.set emFile_1_sclk0__PRTDSI__SYNC_OUT, CYREG_PRT3_SYNC_OUT
.set emFile_1_sclk0__PS, CYREG_PRT3_PS
.set emFile_1_sclk0__SHIFT, 5
.set emFile_1_sclk0__SLW, CYREG_PRT3_SLW

/* PSOC4_IntClock */
.set PSOC4_IntClock__CFG0, CYREG_CLKDIST_DCFG3_CFG0
.set PSOC4_IntClock__CFG1, CYREG_CLKDIST_DCFG3_CFG1
.set PSOC4_IntClock__CFG2, CYREG_CLKDIST_DCFG3_CFG2
.set PSOC4_IntClock__CFG2_SRC_SEL_MASK, 0x07
.set PSOC4_IntClock__INDEX, 0x03
.set PSOC4_IntClock__PM_ACT_CFG, CYREG_PM_ACT_CFG2
.set PSOC4_IntClock__PM_ACT_MSK, 0x08
.set PSOC4_IntClock__PM_STBY_CFG, CYREG_PM_STBY_CFG2
.set PSOC4_IntClock__PM_STBY_MSK, 0x08

/* GPS_IntClock */
.set GPS_IntClock__CFG0, CYREG_CLKDIST_DCFG2_CFG0
.set GPS_IntClock__CFG1, CYREG_CLKDIST_DCFG2_CFG1
.set GPS_IntClock__CFG2, CYREG_CLKDIST_DCFG2_CFG2
.set GPS_IntClock__CFG2_SRC_SEL_MASK, 0x07
.set GPS_IntClock__INDEX, 0x02
.set GPS_IntClock__PM_ACT_CFG, CYREG_PM_ACT_CFG2
.set GPS_IntClock__PM_ACT_MSK, 0x04
.set GPS_IntClock__PM_STBY_CFG, CYREG_PM_STBY_CFG2
.set GPS_IntClock__PM_STBY_MSK, 0x04

/* PWM_1_PWMUDB */
.set PWM_1_PWMUDB_genblk1_ctrlreg__16BIT_CONTROL_AUX_CTL_REG, CYREG_B0_UDB07_08_ACTL
.set PWM_1_PWMUDB_genblk1_ctrlreg__16BIT_CONTROL_CONTROL_REG, CYREG_B0_UDB07_08_CTL
.set PWM_1_PWMUDB_genblk1_ctrlreg__16BIT_CONTROL_COUNT_REG, CYREG_B0_UDB07_08_CTL
.set PWM_1_PWMUDB_genblk1_ctrlreg__16BIT_COUNT_CONTROL_REG, CYREG_B0_UDB07_08_CTL
.set PWM_1_PWMUDB_genblk1_ctrlreg__16BIT_COUNT_COUNT_REG, CYREG_B0_UDB07_08_CTL
.set PWM_1_PWMUDB_genblk1_ctrlreg__16BIT_MASK_MASK_REG, CYREG_B0_UDB07_08_MSK
.set PWM_1_PWMUDB_genblk1_ctrlreg__16BIT_MASK_PERIOD_REG, CYREG_B0_UDB07_08_MSK
.set PWM_1_PWMUDB_genblk1_ctrlreg__16BIT_PERIOD_MASK_REG, CYREG_B0_UDB07_08_MSK
.set PWM_1_PWMUDB_genblk1_ctrlreg__16BIT_PERIOD_PERIOD_REG, CYREG_B0_UDB07_08_MSK
.set PWM_1_PWMUDB_genblk1_ctrlreg__7__MASK, 0x80
.set PWM_1_PWMUDB_genblk1_ctrlreg__7__POS, 7
.set PWM_1_PWMUDB_genblk1_ctrlreg__CONTROL_AUX_CTL_REG, CYREG_B0_UDB07_ACTL
.set PWM_1_PWMUDB_genblk1_ctrlreg__CONTROL_REG, CYREG_B0_UDB07_CTL
.set PWM_1_PWMUDB_genblk1_ctrlreg__CONTROL_ST_REG, CYREG_B0_UDB07_ST_CTL
.set PWM_1_PWMUDB_genblk1_ctrlreg__COUNT_REG, CYREG_B0_UDB07_CTL
.set PWM_1_PWMUDB_genblk1_ctrlreg__COUNT_ST_REG, CYREG_B0_UDB07_ST_CTL
.set PWM_1_PWMUDB_genblk1_ctrlreg__MASK, 0x80
.set PWM_1_PWMUDB_genblk1_ctrlreg__MASK_CTL_AUX_CTL_REG, CYREG_B0_UDB07_MSK_ACTL
.set PWM_1_PWMUDB_genblk1_ctrlreg__PERIOD_REG, CYREG_B0_UDB07_MSK
.set PWM_1_PWMUDB_genblk1_ctrlreg__PER_CTL_AUX_CTL_REG, CYREG_B0_UDB07_MSK_ACTL
.set PWM_1_PWMUDB_genblk8_stsreg__0__MASK, 0x01
.set PWM_1_PWMUDB_genblk8_stsreg__0__POS, 0
.set PWM_1_PWMUDB_genblk8_stsreg__16BIT_STATUS_AUX_CTL_REG, CYREG_B0_UDB05_06_ACTL
.set PWM_1_PWMUDB_genblk8_stsreg__16BIT_STATUS_REG, CYREG_B0_UDB05_06_ST
.set PWM_1_PWMUDB_genblk8_stsreg__2__MASK, 0x04
.set PWM_1_PWMUDB_genblk8_stsreg__2__POS, 2
.set PWM_1_PWMUDB_genblk8_stsreg__3__MASK, 0x08
.set PWM_1_PWMUDB_genblk8_stsreg__3__POS, 3
.set PWM_1_PWMUDB_genblk8_stsreg__5__MASK, 0x20
.set PWM_1_PWMUDB_genblk8_stsreg__5__POS, 5
.set PWM_1_PWMUDB_genblk8_stsreg__MASK, 0x2D
.set PWM_1_PWMUDB_genblk8_stsreg__MASK_REG, CYREG_B0_UDB05_MSK
.set PWM_1_PWMUDB_genblk8_stsreg__STATUS_AUX_CTL_REG, CYREG_B0_UDB05_ACTL
.set PWM_1_PWMUDB_genblk8_stsreg__STATUS_REG, CYREG_B0_UDB05_ST
.set PWM_1_PWMUDB_sP16_pwmdp_u0__16BIT_A0_REG, CYREG_B0_UDB05_06_A0
.set PWM_1_PWMUDB_sP16_pwmdp_u0__16BIT_A1_REG, CYREG_B0_UDB05_06_A1
.set PWM_1_PWMUDB_sP16_pwmdp_u0__16BIT_D0_REG, CYREG_B0_UDB05_06_D0
.set PWM_1_PWMUDB_sP16_pwmdp_u0__16BIT_D1_REG, CYREG_B0_UDB05_06_D1
.set PWM_1_PWMUDB_sP16_pwmdp_u0__16BIT_DP_AUX_CTL_REG, CYREG_B0_UDB05_06_ACTL
.set PWM_1_PWMUDB_sP16_pwmdp_u0__16BIT_F0_REG, CYREG_B0_UDB05_06_F0
.set PWM_1_PWMUDB_sP16_pwmdp_u0__16BIT_F1_REG, CYREG_B0_UDB05_06_F1
.set PWM_1_PWMUDB_sP16_pwmdp_u0__A0_A1_REG, CYREG_B0_UDB05_A0_A1
.set PWM_1_PWMUDB_sP16_pwmdp_u0__A0_REG, CYREG_B0_UDB05_A0
.set PWM_1_PWMUDB_sP16_pwmdp_u0__A1_REG, CYREG_B0_UDB05_A1
.set PWM_1_PWMUDB_sP16_pwmdp_u0__D0_D1_REG, CYREG_B0_UDB05_D0_D1
.set PWM_1_PWMUDB_sP16_pwmdp_u0__D0_REG, CYREG_B0_UDB05_D0
.set PWM_1_PWMUDB_sP16_pwmdp_u0__D1_REG, CYREG_B0_UDB05_D1
.set PWM_1_PWMUDB_sP16_pwmdp_u0__DP_AUX_CTL_REG, CYREG_B0_UDB05_ACTL
.set PWM_1_PWMUDB_sP16_pwmdp_u0__F0_F1_REG, CYREG_B0_UDB05_F0_F1
.set PWM_1_PWMUDB_sP16_pwmdp_u0__F0_REG, CYREG_B0_UDB05_F0
.set PWM_1_PWMUDB_sP16_pwmdp_u0__F1_REG, CYREG_B0_UDB05_F1
.set PWM_1_PWMUDB_sP16_pwmdp_u1__16BIT_A0_REG, CYREG_B0_UDB06_07_A0
.set PWM_1_PWMUDB_sP16_pwmdp_u1__16BIT_A1_REG, CYREG_B0_UDB06_07_A1
.set PWM_1_PWMUDB_sP16_pwmdp_u1__16BIT_D0_REG, CYREG_B0_UDB06_07_D0
.set PWM_1_PWMUDB_sP16_pwmdp_u1__16BIT_D1_REG, CYREG_B0_UDB06_07_D1
.set PWM_1_PWMUDB_sP16_pwmdp_u1__16BIT_DP_AUX_CTL_REG, CYREG_B0_UDB06_07_ACTL
.set PWM_1_PWMUDB_sP16_pwmdp_u1__16BIT_F0_REG, CYREG_B0_UDB06_07_F0
.set PWM_1_PWMUDB_sP16_pwmdp_u1__16BIT_F1_REG, CYREG_B0_UDB06_07_F1
.set PWM_1_PWMUDB_sP16_pwmdp_u1__A0_A1_REG, CYREG_B0_UDB06_A0_A1
.set PWM_1_PWMUDB_sP16_pwmdp_u1__A0_REG, CYREG_B0_UDB06_A0
.set PWM_1_PWMUDB_sP16_pwmdp_u1__A1_REG, CYREG_B0_UDB06_A1
.set PWM_1_PWMUDB_sP16_pwmdp_u1__D0_D1_REG, CYREG_B0_UDB06_D0_D1
.set PWM_1_PWMUDB_sP16_pwmdp_u1__D0_REG, CYREG_B0_UDB06_D0
.set PWM_1_PWMUDB_sP16_pwmdp_u1__D1_REG, CYREG_B0_UDB06_D1
.set PWM_1_PWMUDB_sP16_pwmdp_u1__DP_AUX_CTL_REG, CYREG_B0_UDB06_ACTL
.set PWM_1_PWMUDB_sP16_pwmdp_u1__F0_F1_REG, CYREG_B0_UDB06_F0_F1
.set PWM_1_PWMUDB_sP16_pwmdp_u1__F0_REG, CYREG_B0_UDB06_F0
.set PWM_1_PWMUDB_sP16_pwmdp_u1__F1_REG, CYREG_B0_UDB06_F1

/* PSOC4_BUART */
.set PSOC4_BUART_sRX_RxBitCounter_ST__16BIT_STATUS_AUX_CTL_REG, CYREG_B1_UDB06_07_ACTL
.set PSOC4_BUART_sRX_RxBitCounter_ST__16BIT_STATUS_REG, CYREG_B1_UDB06_07_ST
.set PSOC4_BUART_sRX_RxBitCounter_ST__MASK_REG, CYREG_B1_UDB06_MSK
.set PSOC4_BUART_sRX_RxBitCounter_ST__MASK_ST_AUX_CTL_REG, CYREG_B1_UDB06_MSK_ACTL
.set PSOC4_BUART_sRX_RxBitCounter_ST__PER_ST_AUX_CTL_REG, CYREG_B1_UDB06_MSK_ACTL
.set PSOC4_BUART_sRX_RxBitCounter_ST__STATUS_AUX_CTL_REG, CYREG_B1_UDB06_ACTL
.set PSOC4_BUART_sRX_RxBitCounter_ST__STATUS_CNT_REG, CYREG_B1_UDB06_ST_CTL
.set PSOC4_BUART_sRX_RxBitCounter_ST__STATUS_CONTROL_REG, CYREG_B1_UDB06_ST_CTL
.set PSOC4_BUART_sRX_RxBitCounter_ST__STATUS_REG, CYREG_B1_UDB06_ST
.set PSOC4_BUART_sRX_RxBitCounter__16BIT_CONTROL_AUX_CTL_REG, CYREG_B1_UDB06_07_ACTL
.set PSOC4_BUART_sRX_RxBitCounter__16BIT_CONTROL_CONTROL_REG, CYREG_B1_UDB06_07_CTL
.set PSOC4_BUART_sRX_RxBitCounter__16BIT_CONTROL_COUNT_REG, CYREG_B1_UDB06_07_CTL
.set PSOC4_BUART_sRX_RxBitCounter__16BIT_COUNT_CONTROL_REG, CYREG_B1_UDB06_07_CTL
.set PSOC4_BUART_sRX_RxBitCounter__16BIT_COUNT_COUNT_REG, CYREG_B1_UDB06_07_CTL
.set PSOC4_BUART_sRX_RxBitCounter__16BIT_MASK_MASK_REG, CYREG_B1_UDB06_07_MSK
.set PSOC4_BUART_sRX_RxBitCounter__16BIT_MASK_PERIOD_REG, CYREG_B1_UDB06_07_MSK
.set PSOC4_BUART_sRX_RxBitCounter__16BIT_PERIOD_MASK_REG, CYREG_B1_UDB06_07_MSK
.set PSOC4_BUART_sRX_RxBitCounter__16BIT_PERIOD_PERIOD_REG, CYREG_B1_UDB06_07_MSK
.set PSOC4_BUART_sRX_RxBitCounter__CONTROL_AUX_CTL_REG, CYREG_B1_UDB06_ACTL
.set PSOC4_BUART_sRX_RxBitCounter__CONTROL_REG, CYREG_B1_UDB06_CTL
.set PSOC4_BUART_sRX_RxBitCounter__CONTROL_ST_REG, CYREG_B1_UDB06_ST_CTL
.set PSOC4_BUART_sRX_RxBitCounter__COUNT_REG, CYREG_B1_UDB06_CTL
.set PSOC4_BUART_sRX_RxBitCounter__COUNT_ST_REG, CYREG_B1_UDB06_ST_CTL
.set PSOC4_BUART_sRX_RxBitCounter__MASK_CTL_AUX_CTL_REG, CYREG_B1_UDB06_MSK_ACTL
.set PSOC4_BUART_sRX_RxBitCounter__PERIOD_REG, CYREG_B1_UDB06_MSK
.set PSOC4_BUART_sRX_RxBitCounter__PER_CTL_AUX_CTL_REG, CYREG_B1_UDB06_MSK_ACTL
.set PSOC4_BUART_sRX_RxShifter_u0__16BIT_A0_REG, CYREG_B1_UDB05_06_A0
.set PSOC4_BUART_sRX_RxShifter_u0__16BIT_A1_REG, CYREG_B1_UDB05_06_A1
.set PSOC4_BUART_sRX_RxShifter_u0__16BIT_D0_REG, CYREG_B1_UDB05_06_D0
.set PSOC4_BUART_sRX_RxShifter_u0__16BIT_D1_REG, CYREG_B1_UDB05_06_D1
.set PSOC4_BUART_sRX_RxShifter_u0__16BIT_DP_AUX_CTL_REG, CYREG_B1_UDB05_06_ACTL
.set PSOC4_BUART_sRX_RxShifter_u0__16BIT_F0_REG, CYREG_B1_UDB05_06_F0
.set PSOC4_BUART_sRX_RxShifter_u0__16BIT_F1_REG, CYREG_B1_UDB05_06_F1
.set PSOC4_BUART_sRX_RxShifter_u0__A0_A1_REG, CYREG_B1_UDB05_A0_A1
.set PSOC4_BUART_sRX_RxShifter_u0__A0_REG, CYREG_B1_UDB05_A0
.set PSOC4_BUART_sRX_RxShifter_u0__A1_REG, CYREG_B1_UDB05_A1
.set PSOC4_BUART_sRX_RxShifter_u0__D0_D1_REG, CYREG_B1_UDB05_D0_D1
.set PSOC4_BUART_sRX_RxShifter_u0__D0_REG, CYREG_B1_UDB05_D0
.set PSOC4_BUART_sRX_RxShifter_u0__D1_REG, CYREG_B1_UDB05_D1
.set PSOC4_BUART_sRX_RxShifter_u0__DP_AUX_CTL_REG, CYREG_B1_UDB05_ACTL
.set PSOC4_BUART_sRX_RxShifter_u0__F0_F1_REG, CYREG_B1_UDB05_F0_F1
.set PSOC4_BUART_sRX_RxShifter_u0__F0_REG, CYREG_B1_UDB05_F0
.set PSOC4_BUART_sRX_RxShifter_u0__F1_REG, CYREG_B1_UDB05_F1
.set PSOC4_BUART_sRX_RxSts__16BIT_STATUS_AUX_CTL_REG, CYREG_B0_UDB06_07_ACTL
.set PSOC4_BUART_sRX_RxSts__16BIT_STATUS_REG, CYREG_B0_UDB06_07_ST
.set PSOC4_BUART_sRX_RxSts__3__MASK, 0x08
.set PSOC4_BUART_sRX_RxSts__3__POS, 3
.set PSOC4_BUART_sRX_RxSts__4__MASK, 0x10
.set PSOC4_BUART_sRX_RxSts__4__POS, 4
.set PSOC4_BUART_sRX_RxSts__5__MASK, 0x20
.set PSOC4_BUART_sRX_RxSts__5__POS, 5
.set PSOC4_BUART_sRX_RxSts__MASK, 0x38
.set PSOC4_BUART_sRX_RxSts__MASK_REG, CYREG_B0_UDB06_MSK
.set PSOC4_BUART_sRX_RxSts__STATUS_AUX_CTL_REG, CYREG_B0_UDB06_ACTL
.set PSOC4_BUART_sRX_RxSts__STATUS_REG, CYREG_B0_UDB06_ST
.set PSOC4_BUART_sTX_TxShifter_u0__16BIT_A0_REG, CYREG_B0_UDB07_08_A0
.set PSOC4_BUART_sTX_TxShifter_u0__16BIT_A1_REG, CYREG_B0_UDB07_08_A1
.set PSOC4_BUART_sTX_TxShifter_u0__16BIT_D0_REG, CYREG_B0_UDB07_08_D0
.set PSOC4_BUART_sTX_TxShifter_u0__16BIT_D1_REG, CYREG_B0_UDB07_08_D1
.set PSOC4_BUART_sTX_TxShifter_u0__16BIT_DP_AUX_CTL_REG, CYREG_B0_UDB07_08_ACTL
.set PSOC4_BUART_sTX_TxShifter_u0__16BIT_F0_REG, CYREG_B0_UDB07_08_F0
.set PSOC4_BUART_sTX_TxShifter_u0__16BIT_F1_REG, CYREG_B0_UDB07_08_F1
.set PSOC4_BUART_sTX_TxShifter_u0__A0_A1_REG, CYREG_B0_UDB07_A0_A1
.set PSOC4_BUART_sTX_TxShifter_u0__A0_REG, CYREG_B0_UDB07_A0
.set PSOC4_BUART_sTX_TxShifter_u0__A1_REG, CYREG_B0_UDB07_A1
.set PSOC4_BUART_sTX_TxShifter_u0__D0_D1_REG, CYREG_B0_UDB07_D0_D1
.set PSOC4_BUART_sTX_TxShifter_u0__D0_REG, CYREG_B0_UDB07_D0
.set PSOC4_BUART_sTX_TxShifter_u0__D1_REG, CYREG_B0_UDB07_D1
.set PSOC4_BUART_sTX_TxShifter_u0__DP_AUX_CTL_REG, CYREG_B0_UDB07_ACTL
.set PSOC4_BUART_sTX_TxShifter_u0__F0_F1_REG, CYREG_B0_UDB07_F0_F1
.set PSOC4_BUART_sTX_TxShifter_u0__F0_REG, CYREG_B0_UDB07_F0
.set PSOC4_BUART_sTX_TxShifter_u0__F1_REG, CYREG_B0_UDB07_F1
.set PSOC4_BUART_sTX_TxShifter_u0__MSK_DP_AUX_CTL_REG, CYREG_B0_UDB07_MSK_ACTL
.set PSOC4_BUART_sTX_TxShifter_u0__PER_DP_AUX_CTL_REG, CYREG_B0_UDB07_MSK_ACTL
.set PSOC4_BUART_sTX_TxSts__0__MASK, 0x01
.set PSOC4_BUART_sTX_TxSts__0__POS, 0
.set PSOC4_BUART_sTX_TxSts__16BIT_STATUS_AUX_CTL_REG, CYREG_B1_UDB07_08_ACTL
.set PSOC4_BUART_sTX_TxSts__16BIT_STATUS_REG, CYREG_B1_UDB07_08_ST
.set PSOC4_BUART_sTX_TxSts__1__MASK, 0x02
.set PSOC4_BUART_sTX_TxSts__1__POS, 1
.set PSOC4_BUART_sTX_TxSts__2__MASK, 0x04
.set PSOC4_BUART_sTX_TxSts__2__POS, 2
.set PSOC4_BUART_sTX_TxSts__3__MASK, 0x08
.set PSOC4_BUART_sTX_TxSts__3__POS, 3
.set PSOC4_BUART_sTX_TxSts__MASK, 0x0F
.set PSOC4_BUART_sTX_TxSts__MASK_REG, CYREG_B1_UDB07_MSK
.set PSOC4_BUART_sTX_TxSts__STATUS_AUX_CTL_REG, CYREG_B1_UDB07_ACTL
.set PSOC4_BUART_sTX_TxSts__STATUS_REG, CYREG_B1_UDB07_ST
.set PSOC4_BUART_sTX_sCLOCK_TxBitClkGen__16BIT_A0_REG, CYREG_B0_UDB03_04_A0
.set PSOC4_BUART_sTX_sCLOCK_TxBitClkGen__16BIT_A1_REG, CYREG_B0_UDB03_04_A1
.set PSOC4_BUART_sTX_sCLOCK_TxBitClkGen__16BIT_D0_REG, CYREG_B0_UDB03_04_D0
.set PSOC4_BUART_sTX_sCLOCK_TxBitClkGen__16BIT_D1_REG, CYREG_B0_UDB03_04_D1
.set PSOC4_BUART_sTX_sCLOCK_TxBitClkGen__16BIT_DP_AUX_CTL_REG, CYREG_B0_UDB03_04_ACTL
.set PSOC4_BUART_sTX_sCLOCK_TxBitClkGen__16BIT_F0_REG, CYREG_B0_UDB03_04_F0
.set PSOC4_BUART_sTX_sCLOCK_TxBitClkGen__16BIT_F1_REG, CYREG_B0_UDB03_04_F1
.set PSOC4_BUART_sTX_sCLOCK_TxBitClkGen__A0_A1_REG, CYREG_B0_UDB03_A0_A1
.set PSOC4_BUART_sTX_sCLOCK_TxBitClkGen__A0_REG, CYREG_B0_UDB03_A0
.set PSOC4_BUART_sTX_sCLOCK_TxBitClkGen__A1_REG, CYREG_B0_UDB03_A1
.set PSOC4_BUART_sTX_sCLOCK_TxBitClkGen__D0_D1_REG, CYREG_B0_UDB03_D0_D1
.set PSOC4_BUART_sTX_sCLOCK_TxBitClkGen__D0_REG, CYREG_B0_UDB03_D0
.set PSOC4_BUART_sTX_sCLOCK_TxBitClkGen__D1_REG, CYREG_B0_UDB03_D1
.set PSOC4_BUART_sTX_sCLOCK_TxBitClkGen__DP_AUX_CTL_REG, CYREG_B0_UDB03_ACTL
.set PSOC4_BUART_sTX_sCLOCK_TxBitClkGen__F0_F1_REG, CYREG_B0_UDB03_F0_F1
.set PSOC4_BUART_sTX_sCLOCK_TxBitClkGen__F0_REG, CYREG_B0_UDB03_F0
.set PSOC4_BUART_sTX_sCLOCK_TxBitClkGen__F1_REG, CYREG_B0_UDB03_F1

/* STATUS_LED */
.set STATUS_LED__0__MASK, 0x02
.set STATUS_LED__0__PC, CYREG_PRT3_PC1
.set STATUS_LED__0__PORT, 3
.set STATUS_LED__0__SHIFT, 1
.set STATUS_LED__AG, CYREG_PRT3_AG
.set STATUS_LED__AMUX, CYREG_PRT3_AMUX
.set STATUS_LED__BIE, CYREG_PRT3_BIE
.set STATUS_LED__BIT_MASK, CYREG_PRT3_BIT_MASK
.set STATUS_LED__BYP, CYREG_PRT3_BYP
.set STATUS_LED__CTL, CYREG_PRT3_CTL
.set STATUS_LED__DM0, CYREG_PRT3_DM0
.set STATUS_LED__DM1, CYREG_PRT3_DM1
.set STATUS_LED__DM2, CYREG_PRT3_DM2
.set STATUS_LED__DR, CYREG_PRT3_DR
.set STATUS_LED__INP_DIS, CYREG_PRT3_INP_DIS
.set STATUS_LED__LCD_COM_SEG, CYREG_PRT3_LCD_COM_SEG
.set STATUS_LED__LCD_EN, CYREG_PRT3_LCD_EN
.set STATUS_LED__MASK, 0x02
.set STATUS_LED__PORT, 3
.set STATUS_LED__PRT, CYREG_PRT3_PRT
.set STATUS_LED__PRTDSI__CAPS_SEL, CYREG_PRT3_CAPS_SEL
.set STATUS_LED__PRTDSI__DBL_SYNC_IN, CYREG_PRT3_DBL_SYNC_IN
.set STATUS_LED__PRTDSI__OE_SEL0, CYREG_PRT3_OE_SEL0
.set STATUS_LED__PRTDSI__OE_SEL1, CYREG_PRT3_OE_SEL1
.set STATUS_LED__PRTDSI__OUT_SEL0, CYREG_PRT3_OUT_SEL0
.set STATUS_LED__PRTDSI__OUT_SEL1, CYREG_PRT3_OUT_SEL1
.set STATUS_LED__PRTDSI__SYNC_OUT, CYREG_PRT3_SYNC_OUT
.set STATUS_LED__PS, CYREG_PRT3_PS
.set STATUS_LED__SHIFT, 1
.set STATUS_LED__SLW, CYREG_PRT3_SLW

/* GPS_BUART */
.set GPS_BUART_sRX_RxBitCounter_ST__16BIT_STATUS_AUX_CTL_REG, CYREG_B1_UDB04_05_ACTL
.set GPS_BUART_sRX_RxBitCounter_ST__16BIT_STATUS_REG, CYREG_B1_UDB04_05_ST
.set GPS_BUART_sRX_RxBitCounter_ST__MASK_REG, CYREG_B1_UDB04_MSK
.set GPS_BUART_sRX_RxBitCounter_ST__MASK_ST_AUX_CTL_REG, CYREG_B1_UDB04_MSK_ACTL
.set GPS_BUART_sRX_RxBitCounter_ST__PER_ST_AUX_CTL_REG, CYREG_B1_UDB04_MSK_ACTL
.set GPS_BUART_sRX_RxBitCounter_ST__STATUS_AUX_CTL_REG, CYREG_B1_UDB04_ACTL
.set GPS_BUART_sRX_RxBitCounter_ST__STATUS_CNT_REG, CYREG_B1_UDB04_ST_CTL
.set GPS_BUART_sRX_RxBitCounter_ST__STATUS_CONTROL_REG, CYREG_B1_UDB04_ST_CTL
.set GPS_BUART_sRX_RxBitCounter_ST__STATUS_REG, CYREG_B1_UDB04_ST
.set GPS_BUART_sRX_RxBitCounter__16BIT_CONTROL_AUX_CTL_REG, CYREG_B1_UDB04_05_ACTL
.set GPS_BUART_sRX_RxBitCounter__16BIT_CONTROL_CONTROL_REG, CYREG_B1_UDB04_05_CTL
.set GPS_BUART_sRX_RxBitCounter__16BIT_CONTROL_COUNT_REG, CYREG_B1_UDB04_05_CTL
.set GPS_BUART_sRX_RxBitCounter__16BIT_COUNT_CONTROL_REG, CYREG_B1_UDB04_05_CTL
.set GPS_BUART_sRX_RxBitCounter__16BIT_COUNT_COUNT_REG, CYREG_B1_UDB04_05_CTL
.set GPS_BUART_sRX_RxBitCounter__16BIT_MASK_MASK_REG, CYREG_B1_UDB04_05_MSK
.set GPS_BUART_sRX_RxBitCounter__16BIT_MASK_PERIOD_REG, CYREG_B1_UDB04_05_MSK
.set GPS_BUART_sRX_RxBitCounter__16BIT_PERIOD_MASK_REG, CYREG_B1_UDB04_05_MSK
.set GPS_BUART_sRX_RxBitCounter__16BIT_PERIOD_PERIOD_REG, CYREG_B1_UDB04_05_MSK
.set GPS_BUART_sRX_RxBitCounter__CONTROL_AUX_CTL_REG, CYREG_B1_UDB04_ACTL
.set GPS_BUART_sRX_RxBitCounter__CONTROL_REG, CYREG_B1_UDB04_CTL
.set GPS_BUART_sRX_RxBitCounter__CONTROL_ST_REG, CYREG_B1_UDB04_ST_CTL
.set GPS_BUART_sRX_RxBitCounter__COUNT_REG, CYREG_B1_UDB04_CTL
.set GPS_BUART_sRX_RxBitCounter__COUNT_ST_REG, CYREG_B1_UDB04_ST_CTL
.set GPS_BUART_sRX_RxBitCounter__MASK_CTL_AUX_CTL_REG, CYREG_B1_UDB04_MSK_ACTL
.set GPS_BUART_sRX_RxBitCounter__PERIOD_REG, CYREG_B1_UDB04_MSK
.set GPS_BUART_sRX_RxBitCounter__PER_CTL_AUX_CTL_REG, CYREG_B1_UDB04_MSK_ACTL
.set GPS_BUART_sRX_RxShifter_u0__16BIT_A0_REG, CYREG_B1_UDB07_08_A0
.set GPS_BUART_sRX_RxShifter_u0__16BIT_A1_REG, CYREG_B1_UDB07_08_A1
.set GPS_BUART_sRX_RxShifter_u0__16BIT_D0_REG, CYREG_B1_UDB07_08_D0
.set GPS_BUART_sRX_RxShifter_u0__16BIT_D1_REG, CYREG_B1_UDB07_08_D1
.set GPS_BUART_sRX_RxShifter_u0__16BIT_DP_AUX_CTL_REG, CYREG_B1_UDB07_08_ACTL
.set GPS_BUART_sRX_RxShifter_u0__16BIT_F0_REG, CYREG_B1_UDB07_08_F0
.set GPS_BUART_sRX_RxShifter_u0__16BIT_F1_REG, CYREG_B1_UDB07_08_F1
.set GPS_BUART_sRX_RxShifter_u0__A0_A1_REG, CYREG_B1_UDB07_A0_A1
.set GPS_BUART_sRX_RxShifter_u0__A0_REG, CYREG_B1_UDB07_A0
.set GPS_BUART_sRX_RxShifter_u0__A1_REG, CYREG_B1_UDB07_A1
.set GPS_BUART_sRX_RxShifter_u0__D0_D1_REG, CYREG_B1_UDB07_D0_D1
.set GPS_BUART_sRX_RxShifter_u0__D0_REG, CYREG_B1_UDB07_D0
.set GPS_BUART_sRX_RxShifter_u0__D1_REG, CYREG_B1_UDB07_D1
.set GPS_BUART_sRX_RxShifter_u0__DP_AUX_CTL_REG, CYREG_B1_UDB07_ACTL
.set GPS_BUART_sRX_RxShifter_u0__F0_F1_REG, CYREG_B1_UDB07_F0_F1
.set GPS_BUART_sRX_RxShifter_u0__F0_REG, CYREG_B1_UDB07_F0
.set GPS_BUART_sRX_RxShifter_u0__F1_REG, CYREG_B1_UDB07_F1
.set GPS_BUART_sRX_RxSts__16BIT_STATUS_AUX_CTL_REG, CYREG_B0_UDB04_05_ACTL
.set GPS_BUART_sRX_RxSts__16BIT_STATUS_REG, CYREG_B0_UDB04_05_ST
.set GPS_BUART_sRX_RxSts__3__MASK, 0x08
.set GPS_BUART_sRX_RxSts__3__POS, 3
.set GPS_BUART_sRX_RxSts__4__MASK, 0x10
.set GPS_BUART_sRX_RxSts__4__POS, 4
.set GPS_BUART_sRX_RxSts__5__MASK, 0x20
.set GPS_BUART_sRX_RxSts__5__POS, 5
.set GPS_BUART_sRX_RxSts__MASK, 0x38
.set GPS_BUART_sRX_RxSts__MASK_REG, CYREG_B0_UDB04_MSK
.set GPS_BUART_sRX_RxSts__STATUS_AUX_CTL_REG, CYREG_B0_UDB04_ACTL
.set GPS_BUART_sRX_RxSts__STATUS_REG, CYREG_B0_UDB04_ST

/* PSOC4_Rx */
.set PSOC4_Rx__0__MASK, 0x02
.set PSOC4_Rx__0__PC, CYREG_PRT12_PC1
.set PSOC4_Rx__0__PORT, 12
.set PSOC4_Rx__0__SHIFT, 1
.set PSOC4_Rx__AG, CYREG_PRT12_AG
.set PSOC4_Rx__BIE, CYREG_PRT12_BIE
.set PSOC4_Rx__BIT_MASK, CYREG_PRT12_BIT_MASK
.set PSOC4_Rx__BYP, CYREG_PRT12_BYP
.set PSOC4_Rx__DM0, CYREG_PRT12_DM0
.set PSOC4_Rx__DM1, CYREG_PRT12_DM1
.set PSOC4_Rx__DM2, CYREG_PRT12_DM2
.set PSOC4_Rx__DR, CYREG_PRT12_DR
.set PSOC4_Rx__INP_DIS, CYREG_PRT12_INP_DIS
.set PSOC4_Rx__MASK, 0x02
.set PSOC4_Rx__PORT, 12
.set PSOC4_Rx__PRT, CYREG_PRT12_PRT
.set PSOC4_Rx__PRTDSI__DBL_SYNC_IN, CYREG_PRT12_DBL_SYNC_IN
.set PSOC4_Rx__PRTDSI__OE_SEL0, CYREG_PRT12_OE_SEL0
.set PSOC4_Rx__PRTDSI__OE_SEL1, CYREG_PRT12_OE_SEL1
.set PSOC4_Rx__PRTDSI__OUT_SEL0, CYREG_PRT12_OUT_SEL0
.set PSOC4_Rx__PRTDSI__OUT_SEL1, CYREG_PRT12_OUT_SEL1
.set PSOC4_Rx__PRTDSI__SYNC_OUT, CYREG_PRT12_SYNC_OUT
.set PSOC4_Rx__PS, CYREG_PRT12_PS
.set PSOC4_Rx__SHIFT, 1
.set PSOC4_Rx__SIO_CFG, CYREG_PRT12_SIO_CFG
.set PSOC4_Rx__SIO_DIFF, CYREG_PRT12_SIO_DIFF
.set PSOC4_Rx__SIO_HYST_EN, CYREG_PRT12_SIO_HYST_EN
.set PSOC4_Rx__SIO_REG_HIFREQ, CYREG_PRT12_SIO_REG_HIFREQ
.set PSOC4_Rx__SLW, CYREG_PRT12_SLW

/* PSOC4_Tx */
.set PSOC4_Tx__0__MASK, 0x01
.set PSOC4_Tx__0__PC, CYREG_PRT12_PC0
.set PSOC4_Tx__0__PORT, 12
.set PSOC4_Tx__0__SHIFT, 0
.set PSOC4_Tx__AG, CYREG_PRT12_AG
.set PSOC4_Tx__BIE, CYREG_PRT12_BIE
.set PSOC4_Tx__BIT_MASK, CYREG_PRT12_BIT_MASK
.set PSOC4_Tx__BYP, CYREG_PRT12_BYP
.set PSOC4_Tx__DM0, CYREG_PRT12_DM0
.set PSOC4_Tx__DM1, CYREG_PRT12_DM1
.set PSOC4_Tx__DM2, CYREG_PRT12_DM2
.set PSOC4_Tx__DR, CYREG_PRT12_DR
.set PSOC4_Tx__INP_DIS, CYREG_PRT12_INP_DIS
.set PSOC4_Tx__MASK, 0x01
.set PSOC4_Tx__PORT, 12
.set PSOC4_Tx__PRT, CYREG_PRT12_PRT
.set PSOC4_Tx__PRTDSI__DBL_SYNC_IN, CYREG_PRT12_DBL_SYNC_IN
.set PSOC4_Tx__PRTDSI__OE_SEL0, CYREG_PRT12_OE_SEL0
.set PSOC4_Tx__PRTDSI__OE_SEL1, CYREG_PRT12_OE_SEL1
.set PSOC4_Tx__PRTDSI__OUT_SEL0, CYREG_PRT12_OUT_SEL0
.set PSOC4_Tx__PRTDSI__OUT_SEL1, CYREG_PRT12_OUT_SEL1
.set PSOC4_Tx__PRTDSI__SYNC_OUT, CYREG_PRT12_SYNC_OUT
.set PSOC4_Tx__PS, CYREG_PRT12_PS
.set PSOC4_Tx__SHIFT, 0
.set PSOC4_Tx__SIO_CFG, CYREG_PRT12_SIO_CFG
.set PSOC4_Tx__SIO_DIFF, CYREG_PRT12_SIO_DIFF
.set PSOC4_Tx__SIO_HYST_EN, CYREG_PRT12_SIO_HYST_EN
.set PSOC4_Tx__SIO_REG_HIFREQ, CYREG_PRT12_SIO_REG_HIFREQ
.set PSOC4_Tx__SLW, CYREG_PRT12_SLW

/* Clock_1 */
.set Clock_1__CFG0, CYREG_CLKDIST_DCFG1_CFG0
.set Clock_1__CFG1, CYREG_CLKDIST_DCFG1_CFG1
.set Clock_1__CFG2, CYREG_CLKDIST_DCFG1_CFG2
.set Clock_1__CFG2_SRC_SEL_MASK, 0x07
.set Clock_1__INDEX, 0x01
.set Clock_1__PM_ACT_CFG, CYREG_PM_ACT_CFG2
.set Clock_1__PM_ACT_MSK, 0x02
.set Clock_1__PM_STBY_CFG, CYREG_PM_STBY_CFG2
.set Clock_1__PM_STBY_MSK, 0x02

/* GPS_RX */
.set GPS_RX__0__MASK, 0x40
.set GPS_RX__0__PC, CYREG_PRT3_PC6
.set GPS_RX__0__PORT, 3
.set GPS_RX__0__SHIFT, 6
.set GPS_RX__AG, CYREG_PRT3_AG
.set GPS_RX__AMUX, CYREG_PRT3_AMUX
.set GPS_RX__BIE, CYREG_PRT3_BIE
.set GPS_RX__BIT_MASK, CYREG_PRT3_BIT_MASK
.set GPS_RX__BYP, CYREG_PRT3_BYP
.set GPS_RX__CTL, CYREG_PRT3_CTL
.set GPS_RX__DM0, CYREG_PRT3_DM0
.set GPS_RX__DM1, CYREG_PRT3_DM1
.set GPS_RX__DM2, CYREG_PRT3_DM2
.set GPS_RX__DR, CYREG_PRT3_DR
.set GPS_RX__INP_DIS, CYREG_PRT3_INP_DIS
.set GPS_RX__LCD_COM_SEG, CYREG_PRT3_LCD_COM_SEG
.set GPS_RX__LCD_EN, CYREG_PRT3_LCD_EN
.set GPS_RX__MASK, 0x40
.set GPS_RX__PORT, 3
.set GPS_RX__PRT, CYREG_PRT3_PRT
.set GPS_RX__PRTDSI__CAPS_SEL, CYREG_PRT3_CAPS_SEL
.set GPS_RX__PRTDSI__DBL_SYNC_IN, CYREG_PRT3_DBL_SYNC_IN
.set GPS_RX__PRTDSI__OE_SEL0, CYREG_PRT3_OE_SEL0
.set GPS_RX__PRTDSI__OE_SEL1, CYREG_PRT3_OE_SEL1
.set GPS_RX__PRTDSI__OUT_SEL0, CYREG_PRT3_OUT_SEL0
.set GPS_RX__PRTDSI__OUT_SEL1, CYREG_PRT3_OUT_SEL1
.set GPS_RX__PRTDSI__SYNC_OUT, CYREG_PRT3_SYNC_OUT
.set GPS_RX__PS, CYREG_PRT3_PS
.set GPS_RX__SHIFT, 6
.set GPS_RX__SLW, CYREG_PRT3_SLW

/* Miscellaneous */
/* -- WARNING: define names containing LEOPARD or PANTHER are deprecated and will be removed in a future release */
.set CYDEV_DEBUGGING_DPS_Disable, 3
.set CYDEV_CONFIG_UNUSED_IO_AllowWithInfo, 1
.set CYDEV_CONFIGURATION_MODE_COMPRESSED, 0
.set CYDEV_CONFIG_FASTBOOT_ENABLED, 1
.set CYDEV_CHIP_REV_PSOC5LP_PRODUCTION, 0
.set CYDEV_CHIP_REVISION_5B_PRODUCTION, 0
.set CYDEV_CHIP_MEMBER_5B, 4
.set CYDEV_CHIP_FAMILY_PSOC5, 3
.set CYDEV_CHIP_DIE_PSOC5LP, 4
.set CYDEV_CHIP_DIE_EXPECT, CYDEV_CHIP_DIE_PSOC5LP
.set BCLK__BUS_CLK__HZ, 24000000
.set BCLK__BUS_CLK__KHZ, 24000
.set BCLK__BUS_CLK__MHZ, 24
.set CYDEV_CHIP_DIE_ACTUAL, CYDEV_CHIP_DIE_EXPECT
.set CYDEV_CHIP_DIE_LEOPARD, 1
.set CYDEV_CHIP_DIE_PANTHER, 3
.set CYDEV_CHIP_DIE_PSOC4A, 2
.set CYDEV_CHIP_DIE_UNKNOWN, 0
.set CYDEV_CHIP_FAMILY_PSOC3, 1
.set CYDEV_CHIP_FAMILY_PSOC4, 2
.set CYDEV_CHIP_FAMILY_UNKNOWN, 0
.set CYDEV_CHIP_FAMILY_USED, CYDEV_CHIP_FAMILY_PSOC5
.set CYDEV_CHIP_JTAG_ID, 0x2E127069
.set CYDEV_CHIP_MEMBER_3A, 1
.set CYDEV_CHIP_MEMBER_4A, 2
.set CYDEV_CHIP_MEMBER_5A, 3
.set CYDEV_CHIP_MEMBER_UNKNOWN, 0
.set CYDEV_CHIP_MEMBER_USED, CYDEV_CHIP_MEMBER_5B
.set CYDEV_CHIP_REVISION_3A_ES1, 0
.set CYDEV_CHIP_REVISION_3A_ES2, 1
.set CYDEV_CHIP_REVISION_3A_ES3, 3
.set CYDEV_CHIP_REVISION_3A_PRODUCTION, 3
.set CYDEV_CHIP_REVISION_4A_ES0, 17
.set CYDEV_CHIP_REVISION_4A_PRODUCTION, 17
.set CYDEV_CHIP_REVISION_5A_ES0, 0
.set CYDEV_CHIP_REVISION_5A_ES1, 1
.set CYDEV_CHIP_REVISION_5A_PRODUCTION, 1
.set CYDEV_CHIP_REVISION_5B_ES0, 0
.set CYDEV_CHIP_REVISION_USED, CYDEV_CHIP_REVISION_5B_PRODUCTION
.set CYDEV_CHIP_REV_EXPECT, CYDEV_CHIP_REV_PSOC5LP_PRODUCTION
.set CYDEV_CHIP_REV_LEOPARD_ES1, 0
.set CYDEV_CHIP_REV_LEOPARD_ES2, 1
.set CYDEV_CHIP_REV_LEOPARD_ES3, 3
.set CYDEV_CHIP_REV_LEOPARD_PRODUCTION, 3
.set CYDEV_CHIP_REV_PANTHER_ES0, 0
.set CYDEV_CHIP_REV_PANTHER_ES1, 1
.set CYDEV_CHIP_REV_PANTHER_PRODUCTION, 1
.set CYDEV_CHIP_REV_PSOC4A_ES0, 17
.set CYDEV_CHIP_REV_PSOC4A_PRODUCTION, 17
.set CYDEV_CHIP_REV_PSOC5LP_ES0, 0
.set CYDEV_CONFIGURATION_COMPRESSED, 1
.set CYDEV_CONFIGURATION_DMA, 0
.set CYDEV_CONFIGURATION_ECC, 1
.set CYDEV_CONFIGURATION_IMOENABLED, CYDEV_CONFIG_FASTBOOT_ENABLED
.set CYDEV_CONFIGURATION_MODE, CYDEV_CONFIGURATION_MODE_COMPRESSED
.set CYDEV_CONFIGURATION_MODE_DMA, 2
.set CYDEV_CONFIGURATION_MODE_UNCOMPRESSED, 1
.set CYDEV_CONFIG_UNUSED_IO, CYDEV_CONFIG_UNUSED_IO_AllowWithInfo
.set CYDEV_CONFIG_UNUSED_IO_AllowButWarn, 0
.set CYDEV_CONFIG_UNUSED_IO_Disallowed, 2
.set CYDEV_DEBUGGING_DPS, CYDEV_DEBUGGING_DPS_Disable
.set CYDEV_DEBUGGING_DPS_JTAG_4, 1
.set CYDEV_DEBUGGING_DPS_JTAG_5, 0
.set CYDEV_DEBUGGING_DPS_SWD, 2
.set CYDEV_DEBUGGING_DPS_SWD_SWV, 6
.set CYDEV_DEBUGGING_ENABLE, 1
.set CYDEV_DEBUGGING_XRES, 0
.set CYDEV_DEBUG_ENABLE_MASK, 0x20
.set CYDEV_DEBUG_ENABLE_REGISTER, CYREG_MLOGIC_DEBUG
.set CYDEV_DMA_CHANNELS_AVAILABLE, 24
.set CYDEV_ECC_ENABLE, 0
.set CYDEV_HEAP_SIZE, 0x1000
.set CYDEV_INSTRUCT_CACHE_ENABLED, 1
.set CYDEV_INTR_RISING, 0x00000003
.set CYDEV_PROJ_TYPE, 2
.set CYDEV_PROJ_TYPE_BOOTLOADER, 1
.set CYDEV_PROJ_TYPE_LOADABLE, 2
.set CYDEV_PROJ_TYPE_MULTIAPPBOOTLOADER, 3
.set CYDEV_PROJ_TYPE_STANDARD, 0
.set CYDEV_PROTECTION_ENABLE, 0
.set CYDEV_STACK_SIZE, 0x4000
.set CYDEV_USE_BUNDLED_CMSIS, 1
.set CYDEV_VARIABLE_VDDA, 0
.set CYDEV_VDDA_MV, 5000
.set CYDEV_VDDD_MV, 5000
.set CYDEV_VDDIO0_MV, 5000
.set CYDEV_VDDIO1_MV, 5000
.set CYDEV_VDDIO2_MV, 5000
.set CYDEV_VDDIO3_MV, 5000
.set CYDEV_VIO0, 5
.set CYDEV_VIO0_MV, 5000
.set CYDEV_VIO1, 5
.set CYDEV_VIO1_MV, 5000
.set CYDEV_VIO2, 5
.set CYDEV_VIO2_MV, 5000
.set CYDEV_VIO3, 5
.set CYDEV_VIO3_MV, 5000
.set DMA_CHANNELS_USED__MASK0, 0x00000000
.set CYDEV_BOOTLOADER_ENABLE, 0
.endif
